## drivers/input/fingerprint/Kconfig
```kconfig
config INPUT_FINGERPRINT
	tristate "Fingerprint driver support"
	help
	  Say Y here to enable fingerprint driver support.

source "drivers/input/fingerprint/gf3258/Kconfig"
```

## drivers/input/touchscreen/ipio_touch_driver-v1.0.3.5/Kconfig
```kconfig
#
# ILI9881H touchscreen driver configuration
#
config TOUCHSCREEN_ILI9881H
	bool "ILI9881H"
	default y
	help
	  Say Y here if you have a ILI9881H touchscreen connected
	  to your system.

	  If unsure, say N.
```
