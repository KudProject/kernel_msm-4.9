/* Copyright (c) 2013, The Linux Foundation. All rights reserved.
 *
 * This program is free software; you can redistribute it and/or modify
 * it under the terms of the GNU General Public License version 2 and
 * only version 2 as published by the Free Software Foundation.
 *
 * This program is distributed in the hope that it will be useful,
 * but WITHOUT ANY WARRANTY; without even the implied warranty of
 * MERCHANTABILITY or FITNESS FOR A PARTICULAR PURPOSE.  See the
 * GNU General Public License for more details.
 */

/*---------------------------------------------------------------------------
 * This file is autogenerated file using gcdb parser. Please do not edit it.
 * Update input XML file to add a new entry or update variable in this file
 * VERSION = "1.0"
 *---------------------------------------------------------------------------*/
&mdss_mdp {
	dsi_inx6301_720p_video: qcom,mdss_dsi_inx6301_720p_video {
		qcom,mdss-dsi-panel-name = "inx6301 720p video mode dsi panel";
		qcom,mdss-dsi-panel-controller = <&mdss_dsi0>;
		qcom,mdss-dsi-panel-type = "dsi_video_mode";
		qcom,mdss-dsi-panel-destination = "display_1";
		qcom,mdss-dsi-panel-framerate = <60>;
		qcom,mdss-dsi-virtual-channel-id = <0>;
		qcom,mdss-dsi-stream = <0>;
		qcom,mdss-dsi-panel-width = <720>;
		qcom,mdss-dsi-panel-height = <1520>;
		qcom,mdss-pan-physical-width-dimension = <68>;
		qcom,mdss-pan-physical-height-dimension = <143>;
		qcom,mdss-dsi-h-front-porch = <88>;
		qcom,mdss-dsi-h-back-porch = <130>;
		qcom,mdss-dsi-h-pulse-width = <10>;
		qcom,mdss-dsi-h-sync-skew = <0>;
		qcom,mdss-dsi-v-back-porch = <230>;
		qcom,mdss-dsi-v-front-porch = <8>;
		qcom,mdss-dsi-v-pulse-width = <2>;
		qcom,mdss-dsi-h-left-border = <0>;
		qcom,mdss-dsi-h-right-border = <0>;
		qcom,mdss-dsi-v-top-border = <0>;
		qcom,mdss-dsi-v-bottom-border = <2>;
		qcom,mdss-dsi-bpp = <24>;
		qcom,mdss-dsi-color-order = "rgb_swap_rgb";
		qcom,mdss-dsi-underflow-color = <0xff>;
		qcom,mdss-dsi-border-color = <0>;
		qcom,mdss-dsi-on-command = [39 01 00 00 00 00 02 FF 20
			39 01 00 00 00 00 02 FB 01
			39 01 00 00 00 00 02 01 55
			39 01 00 00 00 00 02 03 55
			39 01 00 00 00 00 02 05 B1
			39 01 00 00 00 00 02 07 73
			39 01 00 00 00 00 02 08 CB
			39 01 00 00 00 00 02 0E 91
			39 01 00 00 00 00 02 0F 69
			39 01 00 00 00 00 02 69 A9
			39 01 00 00 00 00 02 94 C0
			39 01 00 00 00 00 02 95 13
			39 01 00 00 00 00 02 96 13
			39 01 00 00 00 00 02 FF 24
			39 01 00 00 00 00 02 FB 01
			39 01 00 00 00 00 02 93 08
			39 01 00 00 00 00 02 94 06
			39 01 00 00 00 00 02 00 05
			39 01 00 00 00 00 02 01 08
			39 01 00 00 00 00 02 02 00
			39 01 00 00 00 00 02 03 00
			39 01 00 00 00 00 02 0D 18
			39 01 00 00 00 00 02 0E 19
			39 01 00 00 00 00 02 0F 0C
			39 01 00 00 00 00 02 10 0D
			39 01 00 00 00 00 02 11 0E
			39 01 00 00 00 00 02 12 0F
			39 01 00 00 00 00 02 13 10
			39 01 00 00 00 00 02 14 11
			39 01 00 00 00 00 02 15 04
			39 01 00 00 00 00 02 16 05
			39 01 00 00 00 00 02 17 08
			39 01 00 00 00 00 02 18 00
			39 01 00 00 00 00 02 19 00
			39 01 00 00 00 00 02 23 18
			39 01 00 00 00 00 02 24 19
			39 01 00 00 00 00 02 25 0C
			39 01 00 00 00 00 02 26 0D
			39 01 00 00 00 00 02 27 0E
			39 01 00 00 00 00 02 28 0F
			39 01 00 00 00 00 02 29 10
			39 01 00 00 00 00 02 2A 11
			39 01 00 00 00 00 02 2B 04
			39 01 00 00 00 00 02 2F 04
			39 01 00 00 00 00 02 30 32
			39 01 00 00 00 00 02 33 32
			39 01 00 00 00 00 02 34 04
			39 01 00 00 00 00 02 37 44
			39 01 00 00 00 00 02 39 00
			39 01 00 00 00 00 02 3A 10
			39 01 00 00 00 00 02 3B 8F
			39 01 00 00 00 00 02 3D 52
			39 01 00 00 00 00 02 3F 41
			39 01 00 00 00 00 02 40 00
			39 01 00 00 00 00 02 43 41
			39 01 00 00 00 00 02 44 06
			39 01 00 00 00 00 02 47 44
			39 01 00 00 00 00 02 49 00
			39 01 00 00 00 00 02 4A 10
			39 01 00 00 00 00 02 4B 8F
			39 01 00 00 00 00 02 4C 51
			39 01 00 00 00 00 02 4D 12
			39 01 00 00 00 00 02 4E 34
			39 01 00 00 00 00 02 4F 56
			39 01 00 00 00 00 02 51 43
			39 01 00 00 00 00 02 52 21
			39 01 00 00 00 00 02 53 65
			39 01 00 00 00 00 02 55 43
			39 01 00 00 00 00 02 56 46
			39 01 00 00 00 00 02 5A 10
			39 01 00 00 00 00 02 5B 8F
			39 01 00 00 00 00 02 5E 06
			39 01 00 00 00 00 02 5F 00
			39 01 00 00 00 00 02 92 B7
			39 01 00 00 00 00 02 76 00
			39 01 00 00 00 00 02 77 00
			39 01 00 00 00 00 02 78 00
			39 01 00 00 00 00 02 79 00
			39 01 00 00 00 00 02 7A 20
			39 01 00 00 00 00 02 7B 3C
			39 01 00 00 00 00 02 7C 00
			39 01 00 00 00 00 02 7D 00
			39 01 00 00 00 00 02 7E 08
			39 01 00 00 00 00 02 87 02
			39 01 00 00 00 00 02 AB 00
			39 01 00 00 00 00 02 AC 00
			39 01 00 00 00 00 02 AD 00
			39 01 00 00 00 00 02 AF 04
			39 01 00 00 00 00 02 B0 05
			39 01 00 00 00 00 02 B1 B2
			39 01 00 00 00 00 02 60 80
			39 01 00 00 00 00 02 61 7C
			39 01 00 00 00 00 02 64 11
			39 01 00 00 00 00 02 FF 25
			39 01 00 00 00 00 02 FB 01
			39 01 00 00 00 00 02 05 04
			39 01 00 00 00 00 02 07 00
			39 01 00 00 00 00 02 08 01
			39 01 00 00 00 00 02 0A 82
			39 01 00 00 00 00 02 0B 46
			39 01 00 00 00 00 02 0C 01
			39 01 00 00 00 00 02 17 82
			39 01 00 00 00 00 02 18 06
			39 01 00 00 00 00 02 19 0F
			39 01 00 00 00 00 02 1E 00
			39 01 00 00 00 00 02 1F 10
			39 01 00 00 00 00 02 20 8F
			39 01 00 00 00 00 02 23 05
			39 01 00 00 00 00 02 24 B2
			39 01 00 00 00 00 02 25 00
			39 01 00 00 00 00 02 26 10
			39 01 00 00 00 00 02 27 8F
			39 01 00 00 00 00 02 2A 05
			39 01 00 00 00 00 02 2B B2
			39 01 00 00 00 00 02 2D 80
			39 01 00 00 00 00 02 2F 30
			39 01 00 00 00 00 02 30 10
			39 01 00 00 00 00 02 31 00
			39 01 00 00 00 00 02 32 00
			39 01 00 00 00 00 02 33 10
			39 01 00 00 00 00 02 34 8F
			39 01 00 00 00 00 02 37 05
			39 01 00 00 00 00 02 38 B2
			39 01 00 00 00 00 02 40 00
			39 01 00 00 00 00 02 41 80
			39 01 00 00 00 00 02 42 10
			39 01 00 00 00 00 02 43 8F
			39 01 00 00 00 00 02 46 05
			39 01 00 00 00 00 02 47 B2
			39 01 00 00 00 00 02 4A 00
			39 01 00 00 00 00 02 4B 10
			39 01 00 00 00 00 02 4C 8F
			39 01 00 00 00 00 02 4D 10
			39 01 00 00 00 00 02 4E 8F
			39 01 00 00 00 00 02 4F 10
			39 01 00 00 00 00 02 50 8F
			39 01 00 00 00 00 02 53 05
			39 01 00 00 00 00 02 54 B2
			39 01 00 00 00 00 02 55 05
			39 01 00 00 00 00 02 56 B2
			39 01 00 00 00 00 02 58 00
			39 01 00 00 00 00 02 59 00
			39 01 00 00 00 00 02 5A 60
			39 01 00 00 00 00 02 5B 80
			39 01 00 00 00 00 02 5C 00
			39 01 00 00 00 00 02 5D 10
			39 01 00 00 00 00 02 5E 8F
			39 01 00 00 00 00 02 5F 10
			39 01 00 00 00 00 02 60 8F
			39 01 00 00 00 00 02 61 10
			39 01 00 00 00 00 02 62 8F
			39 01 00 00 00 00 02 65 05
			39 01 00 00 00 00 02 66 B2
			39 01 00 00 00 00 02 FF 26
			39 01 00 00 00 00 02 FB 01
			39 01 00 00 00 00 02 00 A0
			39 01 00 00 00 00 02 FF 27
			39 01 00 00 00 00 02 FB 01
			39 01 00 00 00 00 02 96 03
			39 01 00 00 00 00 02 97 15
			39 01 00 00 00 00 02 98 11
			39 01 00 00 00 00 02 99 3F
			39 01 00 00 00 00 02 9B 3F
			39 01 00 00 00 00 02 9D 25
			39 01 00 00 00 00 02 9E 55
			39 01 00 00 00 00 02 9F 05
			39 01 00 00 00 00 02 AD 25
			39 01 00 00 00 00 02 AE 55
			39 01 00 00 00 00 02 AF 05
			39 01 00 00 00 00 02 B3 C6
			39 01 00 00 00 00 02 C0 18
			39 01 00 00 00 00 02 C1 E4
			39 01 00 00 00 00 02 C2 00
			39 01 00 00 00 00 02 C3 00
			39 01 00 00 00 00 02 C4 E4
			39 01 00 00 00 00 02 C5 00
			39 01 00 00 00 00 02 C6 00
			39 01 00 00 00 00 02 C7 03
			39 01 00 00 00 00 02 FF 23
			39 01 00 00 00 00 02 FB 01
			39 01 00 00 00 00 02 12 AB
			39 01 00 00 00 00 02 15 F5
			39 01 00 00 00 00 02 16 0B
			39 01 00 00 00 00 02 FF 20
			39 01 00 00 00 00 02 FB 01
			//R(+) MCR cmd
			39 01 00 00 00 00 11 B0 00 00 00 13 00 32 00 4C 00 62 00 76 00 88 00 98
			39 01 00 00 00 00 11 B1 00 A7 00 D7 00 FD 01 37 01 63 01 A7 01 DE 01 DF
			39 01 00 00 00 00 11 B2 02 10 02 4B 02 71 02 A8 02 CF 02 FA 03 06 03 1B
			39 01 00 00 00 00 0D B3 03 35 03 4B 03 64 03 84 03 B3 03 FF
			//G(+) MCR cmd
			39 01 00 00 00 00 11 B4 00 00 00 13 00 32 00 4C 00 62 00 76 00 88 00 98
			39 01 00 00 00 00 11 B5 00 A7 00 D7 00 FD 01 37 01 63 01 A7 01 DE 01 DF
			39 01 00 00 00 00 11 B6 02 10 02 4B 02 71 02 A8 02 CF 02 FA 03 06 03 1B
			39 01 00 00 00 00 0D B7 03 35 03 4B 03 64 03 84 03 B3 03 FF
			//B(+) MCR cmd
			39 01 00 00 00 00 11 B8 00 00 00 13 00 32 00 4C 00 62 00 76 00 88 00 98
			39 01 00 00 00 00 11 B9 00 A7 00 D7 00 FD 01 37 01 63 01 A7 01 DE 01 DF
			39 01 00 00 00 00 11 BA 02 10 02 4B 02 71 02 A8 02 CF 02 FA 03 06 03 1B
			39 01 00 00 00 00 0D BB 03 35 03 4B 03 64 03 84 03 B3 03 FF
			//page selection cmd start
			39 01 00 00 00 00 02 FF 21
			39 01 00 00 00 00 02 FB 01
			//page selection cmd end
			//R(-) MCR cmd
			39 01 00 00 00 00 11 B0 00 00 00 13 00 32 00 4C 00 62 00 76 00 88 00 98
			39 01 00 00 00 00 11 B1 00 A7 00 D7 00 FD 01 37 01 63 01 A7 01 DE 01 DF
			39 01 00 00 00 00 11 B2 02 10 02 4B 02 71 02 A8 02 CF 02 FA 03 06 03 1B
			39 01 00 00 00 00 0D B3 03 35 03 4B 03 64 03 84 03 B3 03 FF
			//G(-) MCR cmd
			39 01 00 00 00 00 11 B4 00 00 00 13 00 32 00 4C 00 62 00 76 00 88 00 98
			39 01 00 00 00 00 11 B5 00 A7 00 D7 00 FD 01 37 01 63 01 A7 01 DE 01 DF
			39 01 00 00 00 00 11 B6 02 10 02 4B 02 71 02 A8 02 CF 02 FA 03 06 03 1B
			39 01 00 00 00 00 0D B7 03 35 03 4B 03 64 03 84 03 B3 03 FF
			//B(-) MCR cmd
			39 01 00 00 00 00 11 B8 00 00 00 13 00 32 00 4C 00 62 00 76 00 88 00 98
			39 01 00 00 00 00 11 B9 00 A7 00 D7 00 FD 01 37 01 63 01 A7 01 DE 01 DF
			39 01 00 00 00 00 11 BA 02 10 02 4B 02 71 02 A8 02 CF 02 FA 03 06 03 1B
			39 01 00 00 00 00 0D BB 03 35 03 4B 03 64 03 84 03 B3 03 FF

			39 01 00 00 00 00 02 FF 23
			39 01 00 00 00 00 02 FB 01
			39 01 00 00 00 00 02 10 80
			39 01 00 00 00 00 02 11 00
			39 01 00 00 00 00 02 12 AB
			39 01 00 00 00 00 02 15 F5
			39 01 00 00 00 00 02 16 0B
			39 01 00 00 00 00 02 19 00
			39 01 00 00 00 00 02 1A 20
			39 01 00 00 00 00 02 1B 22
			39 01 00 00 00 00 02 1C 24
			39 01 00 00 00 00 02 1D 26
			39 01 00 00 00 00 02 1E 28
			39 01 00 00 00 00 02 1F 2A
			39 01 00 00 00 00 02 20 2C
			39 01 00 00 00 00 02 21 2E
			39 01 00 00 00 00 02 22 30
			39 01 00 00 00 00 02 23 32
			39 01 00 00 00 00 02 24 34
			39 01 00 00 00 00 02 25 36
			39 01 00 00 00 00 02 26 34
			39 01 00 00 00 00 02 27 38
			39 01 00 00 00 00 02 28 3C
			39 01 00 00 00 00 02 45 FF
			39 01 00 00 00 00 02 46 FA
			39 01 00 00 00 00 02 47 F6
			39 01 00 00 00 00 02 48 F4
			39 01 00 00 00 00 02 49 EE
			39 01 00 00 00 00 02 4A E8
			39 01 00 00 00 00 02 4B E0
			39 01 00 00 00 00 02 4C D8
			39 01 00 00 00 00 02 4D D2
			39 01 00 00 00 00 02 4E CE
			39 01 00 00 00 00 02 4F CA
			39 01 00 00 00 00 02 50 C6
			39 01 00 00 00 00 02 51 C2
			39 01 00 00 00 00 02 52 BE
			39 01 00 00 00 00 02 53 B8
			39 01 00 00 00 00 02 54 B2
			39 01 00 00 00 00 02 70 41
			39 01 00 00 00 00 02 71 54
			39 01 00 00 00 00 02 FF 20
			39 01 00 00 00 00 11 C0 10 1A 2A 24 37 3E 3F 3F 3E 3E 3D 3E 3F 3D 3D 38
			39 01 00 00 00 00 0D C1 28 25 1A 11 10 12 1F 0E 0B 0D 16 2B
			39 01 00 00 00 00 11 C2 0A 1B 24 2E 3F 3F 3F 3F 3F 3F 3F 3F 3F 3F 3F 3A
			39 01 00 00 00 00 0D C3 29 26 1A 11 11 13 1F 0E 0D 0D 17 1F
			39 01 00 00 00 00 11 C4 0C 19 24 26 39 3F 3F 3F 3F 3E 3D 3D 3D 3D 3D 3A
			39 01 00 00 00 00 0D C5 29 26 1B 12 13 0D 21 18 11 14 26 2C
			15 01 00 00 00 00 02 FF 23
			15 01 00 00 00 00 02 FB 01
			15 01 00 00 00 00 02 00 80   // 80:12BIT PWM 00:8BIT
			15 01 00 00 00 00 02 07 00
			15 01 00 00 00 00 02 08 01
			15 01 00 00 00 00 02 09 00   //80KHz
			39 01 00 00 00 00 02 FF 10
			39 01 00 00 00 00 02 FB 01
			39 01 00 00 00 00 02 BA 02
			39 01 00 00 00 00 02 35 00
			39 01 00 00 00 00 03 51 00 00
			39 01 00 00 00 00 02 53 2C
			39 01 00 00 00 00 02 55 02
			39 01 00 00 00 00 03 68 02 01
			05 01 00 00 64 00 02 11 00
			05 01 00 00 00 00 02 29 00];
		qcom,mdss-dsi-off-command = [
					05 01 00 00 78 00 02 10 00];
		qcom,mdss-dsi-on-command-state = "dsi_lp_mode";
		qcom,mdss-dsi-off-command-state = "dsi_hs_mode";
		qcom,mdss-dsi-h-sync-pulse = <1>;
		qcom,mdss-dsi-traffic-mode = "burst_mode";
		qcom,mdss-dsi-lane-map = "lane_map_0123";
		qcom,mdss-dsi-bllp-eof-power-mode;
		qcom,mdss-dsi-bllp-power-mode;
		qcom,mdss-dsi-lane-0-state;
		qcom,mdss-dsi-lane-1-state;
		qcom,mdss-dsi-lane-2-state;
		qcom,mdss-dsi-panel-timings-phy-v2 = [
			22 1E 07 08 04 03 04 0a
			22 1E 07 08 04 03 04 0a
			22 1E 07 08 04 03 04 0a
			22 1E 07 08 04 03 04 0a
			22 18 07 08 04 03 04 0a];
		qcom,mdss-dsi-t-clk-post = <0x0d>;
		qcom,mdss-dsi-t-clk-pre = <0x2c>;
		qcom,mdss-dsi-bl-min-level = <1>;
		qcom,mdss-dsi-bl-max-level = <4095>;
                qcom,esd-check-enabled;
                qcom,mdss-dsi-panel-status-command      = [06 01 00 01 05 00 01 0A];
                qcom,mdss-dsi-panel-status-command-mode = "dsi_lp_mpde";
                qcom,mdss-dsi-panel-status-check-mode   = "reg_read";
                qcom,mdss-dsi-panel-status-read-length  = <1>;
                qcom,mdss-dsi-panel-status-valid-params = <1>;
                qcom,mdss-dsi-panel-status-value        = <0x9C>;
                qcom,mdss-dsi-panel-max-error-count     = <3>;
		qcom,mdss-dsi-init-delay-us = <50000>;
		qcom,mdss-dsi-dma-trigger = "trigger_sw";
		qcom,mdss-dsi-mdp-trigger = "none";
		qcom,mdss-dsi-bl-pmic-control-type = "bl_ctrl_dcs";
		qcom,mdss-dsi-reset-sequence = <1 10>, <0 10>, <1 1>;
		qcom,panel-supply-entries = <&dsi_panel_pwr_supply>;
	};
};
