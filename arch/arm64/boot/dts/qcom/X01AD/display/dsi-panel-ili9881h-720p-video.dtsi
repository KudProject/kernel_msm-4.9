/* Copyright (c) 2013, The Linux Foundation. All rights reserved.
 *
 * This program is free software; you can redistribute it and/or modify
 * it under the terms of the GNU General Public License version 2 and
 * only version 2 as published by the Free Software Foundation.
 *
 * This program is distributed in the hope that it will be useful,
 * but WITHOUT ANY WARRANTY; without even the implied warranty of
 * MERCHANTABILITY or FITNESS FOR A PARTICULAR PURPOSE.  See the
 * GNU General Public License for more details.
 */

/*---------------------------------------------------------------------------
 * This file is autogenerated file using gcdb parser. Please do not edit it.
 * Update input XML file to add a new entry or update variable in this file
 * VERSION = "1.0"
 *---------------------------------------------------------------------------*/
&mdss_mdp {
	dsi_ili9881h_720p_video: qcom,mdss_dsi_ili9881h_720p_video {
		qcom,mdss-dsi-panel-name = "ili9881h 720p video mode dsi panel";
		qcom,mdss-dsi-panel-controller = <&mdss_dsi0>;
		qcom,mdss-dsi-panel-type = "dsi_video_mode";
		qcom,mdss-dsi-panel-destination = "display_1";
		qcom,mdss-dsi-panel-framerate = <60>;
		qcom,mdss-dsi-virtual-channel-id = <0>;
		qcom,mdss-dsi-stream = <0>;
		qcom,mdss-dsi-panel-width = <720>;
		qcom,mdss-dsi-panel-height = <1520>;
		qcom,mdss-pan-physical-width-dimension = <68>;
		qcom,mdss-pan-physical-height-dimension = <143>;
                qcom,mdss-dsi-h-front-porch = <88>;
                qcom,mdss-dsi-h-back-porch = <88>;
                qcom,mdss-dsi-h-pulse-width = <8>;
                qcom,mdss-dsi-h-sync-skew = <0>;
                qcom,mdss-dsi-v-back-porch = <12>;
                qcom,mdss-dsi-v-front-porch = <40>;
                qcom,mdss-dsi-v-pulse-width = <4>;
		qcom,mdss-dsi-h-left-border = <0>;
		qcom,mdss-dsi-h-right-border = <0>;
		qcom,mdss-dsi-v-top-border = <0>;
		qcom,mdss-dsi-v-bottom-border = <0>;
		qcom,mdss-dsi-bpp = <24>;
		qcom,mdss-dsi-color-order = "rgb_swap_rgb";
		qcom,mdss-dsi-underflow-color = <0xff>;
		qcom,mdss-dsi-border-color = <0>;
		qcom,mdss-dsi-on-command = [
					39 01 00 00 00 00 04 FF 98 81 01
					39 01 00 00 00 00 02 00 48
					39 01 00 00 00 00 02 01 33
					39 01 00 00 00 00 02 02 FF
					39 01 00 00 00 00 02 03 05
					39 01 00 00 00 00 02 08 86
					39 01 00 00 00 00 02 09 01
					39 01 00 00 00 00 02 0a 73
					39 01 00 00 00 00 02 0b 00
					39 01 00 00 00 00 02 0c FF
					39 01 00 00 00 00 02 0d FF
					39 01 00 00 00 00 02 0e 05
					39 01 00 00 00 00 02 0f 05
					39 01 00 00 00 00 02 28 48
					39 01 00 00 00 00 02 29 86
					39 01 00 00 00 00 02 2D 60
					39 01 00 00 00 00 02 31 07
					39 01 00 00 00 00 02 32 02
					39 01 00 00 00 00 02 33 00
					39 01 00 00 00 00 02 34 2a
					39 01 00 00 00 00 02 35 09
					39 01 00 00 00 00 02 36 0b
					39 01 00 00 00 00 02 37 15
					39 01 00 00 00 00 02 38 17
					39 01 00 00 00 00 02 39 11
					39 01 00 00 00 00 02 3a 13
					39 01 00 00 00 00 02 3b 06
					39 01 00 00 00 00 02 3c 01
					39 01 00 00 00 00 02 3d 07
					39 01 00 00 00 00 02 3e 07
					39 01 00 00 00 00 02 3f 07
					39 01 00 00 00 00 02 40 07
					39 01 00 00 00 00 02 41 07
					39 01 00 00 00 00 02 42 07
					39 01 00 00 00 00 02 43 07
					39 01 00 00 00 00 02 44 07
					39 01 00 00 00 00 02 45 07
					39 01 00 00 00 00 02 46 07
					39 01 00 00 00 00 02 47 07
					39 01 00 00 00 00 02 48 02
					39 01 00 00 00 00 02 49 00
					39 01 00 00 00 00 02 4a 2A
					39 01 00 00 00 00 02 4b 08
					39 01 00 00 00 00 02 4c 0A
					39 01 00 00 00 00 02 4d 14
					39 01 00 00 00 00 02 4e 16
					39 01 00 00 00 00 02 4f 10
					39 01 00 00 00 00 02 50 12
					39 01 00 00 00 00 02 51 06
					39 01 00 00 00 00 02 52 01
					39 01 00 00 00 00 02 53 07
					39 01 00 00 00 00 02 54 07
					39 01 00 00 00 00 02 55 07
					39 01 00 00 00 00 02 56 07
					39 01 00 00 00 00 02 57 07
					39 01 00 00 00 00 02 58 07
					39 01 00 00 00 00 02 59 07
					39 01 00 00 00 00 02 5a 07
					39 01 00 00 00 00 02 5b 07
					39 01 00 00 00 00 02 5c 07
					39 01 00 00 00 00 02 61 07
					39 01 00 00 00 00 02 62 02
					39 01 00 00 00 00 02 63 00
					39 01 00 00 00 00 02 64 2a
					39 01 00 00 00 00 02 65 0a
					39 01 00 00 00 00 02 66 08
					39 01 00 00 00 00 02 67 12
					39 01 00 00 00 00 02 68 10
					39 01 00 00 00 00 02 69 16
					39 01 00 00 00 00 02 6a 14
					39 01 00 00 00 00 02 6b 22
					39 01 00 00 00 00 02 6c 01
					39 01 00 00 00 00 02 6d 07
					39 01 00 00 00 00 02 6e 07
					39 01 00 00 00 00 02 6f 07
					39 01 00 00 00 00 02 70 07
					39 01 00 00 00 00 02 71 07
					39 01 00 00 00 00 02 72 07
					39 01 00 00 00 00 02 73 07
					39 01 00 00 00 00 02 74 07
					39 01 00 00 00 00 02 75 07
					39 01 00 00 00 00 02 76 07
					39 01 00 00 00 00 02 77 07
					39 01 00 00 00 00 02 78 02
					39 01 00 00 00 00 02 79 00
					39 01 00 00 00 00 02 7a 2a
					39 01 00 00 00 00 02 7b 0b
					39 01 00 00 00 00 02 7c 09
					39 01 00 00 00 00 02 7d 13
					39 01 00 00 00 00 02 7e 11
					39 01 00 00 00 00 02 7f 17
					39 01 00 00 00 00 02 80 15
					39 01 00 00 00 00 02 81 22
					39 01 00 00 00 00 02 82 01
					39 01 00 00 00 00 02 83 07
					39 01 00 00 00 00 02 84 07
					39 01 00 00 00 00 02 85 07
					39 01 00 00 00 00 02 86 07
					39 01 00 00 00 00 02 87 07
					39 01 00 00 00 00 02 88 07
					39 01 00 00 00 00 02 89 07
					39 01 00 00 00 00 02 8a 07
					39 01 00 00 00 00 02 8b 07
					39 01 00 00 00 00 02 8c 07
					39 01 00 00 00 00 02 a0 01
					39 01 00 00 00 00 02 a1 FF
					39 01 00 00 00 00 02 a2 05
					39 01 00 00 00 00 02 a7 9A
					39 01 00 00 00 00 02 a8 9A
					39 01 00 00 00 00 02 a9 14
					39 01 00 00 00 00 02 aa 14
					39 01 00 00 00 00 02 b0 34
					39 01 00 00 00 00 02 b2 04
					39 01 00 00 00 00 02 b9 00
					39 01 00 00 00 00 02 ba 01
					39 01 00 00 00 00 02 c1 10
					39 01 00 00 00 00 02 d0 01
					39 01 00 00 00 00 02 d1 00
					39 01 00 00 00 00 02 e2 00
					39 01 00 00 00 00 02 e6 42
					39 01 00 00 00 00 02 ea 0F
					39 01 00 00 00 00 02 B0 34
					39 01 00 00 00 00 02 B2 04
					39 01 00 00 00 00 02 E7 54
					39 01 00 00 00 00 04 FF 98 81 02
					39 01 00 00 00 00 02 40 48
					39 01 00 00 00 00 02 70 35
					39 01 00 00 00 00 02 73 09
					39 01 00 00 00 00 02 79 f5
					39 01 00 00 00 00 02 4B 5A
					39 01 00 00 00 00 02 4D 4E
					39 01 00 00 00 00 02 4E 00
					39 01 00 00 00 00 02 19 38
					39 01 00 00 00 00 02 1A 38
					39 01 00 00 00 00 02 52 48
					39 01 00 00 00 00 02 57 48
					39 01 00 00 00 00 04 FF 98 81 05
					39 01 00 00 00 00 02 03 01
					39 01 00 00 00 00 02 04 35
					39 01 00 00 00 00 02 50 1F
					39 01 00 00 00 00 02 58 63
					39 01 00 00 00 00 02 63 97
					39 01 00 00 00 00 02 64 97
					39 01 00 00 00 00 02 68 65
					39 01 00 00 00 00 02 69 6B
					39 01 00 00 00 00 02 6A F1
					39 01 00 00 00 00 02 6B E3
					39 01 00 00 00 00 04 FF 98 81 06
					39 01 00 00 00 00 02 DD 10
					39 01 00 00 00 00 02 11 03

					39 01 00 00 00 00 02 13 97
					39 01 00 00 00 00 02 14 41
					39 01 00 00 00 00 02 15 44
					39 01 00 00 00 00 02 16 41

					39 01 00 00 00 00 02 17 48
					39 01 00 00 00 00 02 18 3B
					39 01 00 00 00 00 02 D6 85
					39 01 00 00 00 00 02 27 20
					39 01 00 00 00 00 02 28 20
					39 01 00 00 00 00 02 2E 01
					39 01 00 00 00 00 02 C0 F7
					39 01 00 00 00 00 02 C1 02
					39 01 00 00 00 00 02 C2 04
					39 01 00 00 00 00 02 48 0F
					39 01 00 00 00 00 02 4D 80
					39 01 00 00 00 00 02 4E 40
					39 01 00 00 00 00 02 C7 05
					39 01 00 00 00 00 02 7C 40
					39 01 00 00 00 00 04 FF 98 81 07
					39 01 00 00 00 00 02 0F 02
					39 01 00 00 00 00 04 FF 98 81 08
					39 01 00 00 00 00 1C E0 00 24 43 60 8A 50 B2 D6 03 2B 95 6C A3 D7 09 AA 3D 7B A2 D1 FE FA 2C 69 9C 03 EC
					39 01 00 00 00 00 1C E1 00 24 43 60 8A 50 B2 D6 03 2B 95 6C A3 D7 09 AA 3D 7B A2 D1 FE FA 2C 69 9C 03 EC
					39 01 00 00 00 00 04 FF 98 81 0E
					39 01 00 00 00 00 02 00 A1
					39 01 00 00 00 00 02 01 28
					39 01 00 00 00 00 02 02 10
					39 01 00 00 00 00 02 13 10
					39 01 00 00 00 00 02 41 00
					39 01 00 00 00 00 02 43 60
					39 01 00 00 00 00 02 20 07
					39 01 00 00 00 00 02 29 BE
					39 01 00 00 00 00 02 45 0A
					39 01 00 00 00 00 02 46 23
					39 01 00 00 00 00 02 27 80
					39 01 00 00 00 00 02 2D 95
					39 01 00 00 00 00 02 2E 87
					39 01 00 00 00 00 02 2F 87
					39 01 00 00 00 00 02 40 07
					39 01 00 00 00 00 02 49 BE
					39 01 00 00 00 00 02 4D 95
					39 01 00 00 00 00 02 C0 11
					39 01 00 00 00 00 02 C1 80
					39 01 00 00 00 00 02 C2 08
					39 01 00 00 00 00 02 C3 01
					39 01 00 00 00 00 02 C4 44
					39 01 00 00 00 00 02 C5 44
					39 01 00 00 00 00 02 C6 44
					39 01 00 00 00 00 02 C7 40
					39 01 00 00 00 00 02 D0 35
					39 01 00 00 00 00 02 D1 02
					39 01 00 00 00 00 02 D2 00
					39 01 00 00 00 00 02 D3 95
					39 01 00 00 00 00 02 D4 95
					39 01 00 00 00 00 02 D5 95
					39 01 00 00 00 00 02 D6 95
					39 01 00 00 00 00 02 D7 95
					39 01 00 00 00 00 02 D8 95
					39 01 00 00 00 00 02 D9 98
					39 01 00 00 00 00 02 DA 11
					39 01 00 00 00 00 02 DB 44
					39 01 00 00 00 00 02 DC 44
					39 01 00 00 00 00 02 DD 44
					39 01 00 00 00 00 02 E1 08
					39 01 00 00 00 00 02 E2 19
					39 01 00 00 00 00 02 E3 10
					39 01 00 00 00 00 02 05 03
					39 01 00 00 00 00 02 07 21
					39 01 00 00 00 00 02 4B 19
					39 01 00 00 00 00 04 FF 98 81 0C
					39 01 00 00 00 00 02 00 10
					39 01 00 00 00 00 02 01 0C
					39 01 00 00 00 00 02 02 10
					39 01 00 00 00 00 02 03 0E
					39 01 00 00 00 00 02 04 10
					39 01 00 00 00 00 02 05 0D
					39 01 00 00 00 00 02 06 10
					39 01 00 00 00 00 02 07 10
					39 01 00 00 00 00 02 08 10
					39 01 00 00 00 00 02 09 0F
					39 01 00 00 00 00 02 0A 11
					39 01 00 00 00 00 02 0B 12
					39 01 00 00 00 00 02 0C 11
					39 01 00 00 00 00 02 0D 11
					39 01 00 00 00 00 02 0E 11
					39 01 00 00 00 00 02 0F 14
					39 01 00 00 00 00 02 10 11
					39 01 00 00 00 00 02 11 16
					39 01 00 00 00 00 02 12 11
					39 01 00 00 00 00 02 13 15
					39 01 00 00 00 00 02 14 11
					39 01 00 00 00 00 02 15 13
					39 01 00 00 00 00 02 16 11
					39 01 00 00 00 00 02 17 17
					39 01 00 00 00 00 02 18 11
					39 01 00 00 00 00 02 19 19
					39 01 00 00 00 00 02 1A 11
					39 01 00 00 00 00 02 1B 18
					39 01 00 00 00 00 02 1C 11
					39 01 00 00 00 00 02 1D 1A
					39 01 00 00 00 00 02 1E 12
					39 01 00 00 00 00 02 1F 1C
					39 01 00 00 00 00 02 20 12
					39 01 00 00 00 00 02 21 1B
					39 01 00 00 00 00 02 22 12
					39 01 00 00 00 00 02 23 1D
					39 01 00 00 00 00 02 24 12
					39 01 00 00 00 00 02 25 21
					39 01 00 00 00 00 02 26 12
					39 01 00 00 00 00 02 27 1F
					39 01 00 00 00 00 02 28 12
					39 01 00 00 00 00 02 29 1E
					39 01 00 00 00 00 02 2A 12
					39 01 00 00 00 00 02 2B 20
					39 01 00 00 00 00 02 2C 12
					39 01 00 00 00 00 02 2D 22
					39 01 00 00 00 00 02 2E 13
					39 01 00 00 00 00 02 2F 24
					39 01 00 00 00 00 02 30 13
					39 01 00 00 00 00 02 31 23
					39 01 00 00 00 00 02 32 13
					39 01 00 00 00 00 02 33 25
					39 01 00 00 00 00 04 FF 98 81 06
					39 01 00 00 00 00 02 06 C4
					39 01 00 00 00 00 02 83 00
					39 01 00 00 00 00 02 84 00
					39 01 00 00 00 00 04 FF 98 81 04
					39 01 00 00 00 00 02 01 85
					39 01 00 00 00 00 02 87 0E
					39 01 00 00 00 00 04 FF 98 81 03
					39 01 00 00 00 00 02 83 B8
					39 01 00 00 00 00 02 84 00
					39 01 00 00 00 00 02 86 64
					39 01 00 00 00 00 02 A8 C6
					39 01 00 00 00 00 02 AA E5
					39 01 00 00 00 00 02 AE C9
					39 01 00 00 00 00 02 94 0D
					39 01 00 00 00 00 02 95 10
					39 01 00 00 00 00 02 96 10
					39 01 00 00 00 00 02 97 10
					39 01 00 00 00 00 02 98 10
					39 01 00 00 00 00 04 FF 98 81 00
					39 01 00 00 00 00 03 51 00 00
					39 01 00 00 00 00 02 53 2C
					39 01 00 00 00 00 02 55 02
					39 01 00 00 00 00 03 68 02 01
					39 01 00 00 00 00 02 36 00
					39 01 00 00 40 00 02 11 00
					39 01 00 00 00 00 02 29 00
					39 01 00 00 00 00 02 35 00];
		qcom,mdss-dsi-off-command = [39 01 00 00 00 00 04 FF 98 81 00 
					05 01 00 00 32 00 02 28 00
					05 01 00 00 78 00 02 10 00];
		qcom,mdss-dsi-on-command-state = "dsi_lp_mode";
		qcom,mdss-dsi-off-command-state = "dsi_hs_mode";
		qcom,mdss-dsi-h-sync-pulse = <1>;
		qcom,mdss-dsi-traffic-mode = "burst_mode";
		qcom,mdss-dsi-lane-map = "lane_map_0123";
		qcom,mdss-dsi-bllp-eof-power-mode;
		qcom,mdss-dsi-bllp-power-mode;
		qcom,mdss-dsi-lane-0-state;
		qcom,mdss-dsi-lane-1-state;
		qcom,mdss-dsi-lane-2-state;
		qcom,mdss-dsi-panel-timings-phy-v2 = [21 1e 06 07 04 03 04 0a
			21 1e 06 07 04 03 04 0a
			21 1e 06 07 04 03 04 0a
			21 1e 06 07 04 03 04 0a
			21 15 06 07 04 03 04 0a];
		qcom,mdss-dsi-t-clk-post = <0x0c>;
		qcom,mdss-dsi-t-clk-pre = <0x28>;
		qcom,mdss-dsi-lp11-init;
		qcom,mdss-dsi-init-delay-us = <20000>;
		qcom,mdss-dsi-bl-min-level = <1>;
		qcom,mdss-dsi-bl-max-level = <2047>;
                qcom,esd-check-enabled;
                qcom,mdss-dsi-panel-status-command      = [06 01 00 01 05 00 01 0A];
                qcom,mdss-dsi-panel-status-command-mode = "dsi_lp_mpde";
                qcom,mdss-dsi-panel-status-check-mode   = "reg_read";
                qcom,mdss-dsi-panel-status-read-length  = <1>;
                qcom,mdss-dsi-panel-status-valid-params = <1>;
                qcom,mdss-dsi-panel-status-value        = <0x9C>;
                qcom,mdss-dsi-panel-max-error-count     = <3>;
		qcom,mdss-dsi-dma-trigger = "trigger_sw";
		qcom,mdss-dsi-mdp-trigger = "none";
		qcom,mdss-dsi-bl-pmic-control-type = "bl_ctrl_dcs";
		qcom,mdss-dsi-reset-sequence = <1 5>, <0 2>, <1 5>;
		qcom,panel-supply-entries = <&dsi_panel_pwr_supply>;
	};
};
