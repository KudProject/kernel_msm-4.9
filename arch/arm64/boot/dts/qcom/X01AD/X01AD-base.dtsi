#include "X01AD-msm8953.dtsi"
#include "X01AD-msm8953-audio.dtsi"
#include "X01AD-msm8953-camera-sensor-qrd.dtsi"
#include "X01AD-msm8953-pinctrl.dtsi"
#include "X01AD-msm8953-regulator.dtsi"
#include "X01AD-msm8953-thermal.dtsi"
#include "X01AD-pm8953.dtsi"
#include "X01AD-pmi632.dtsi"
#include "X01AD-sdm450-pmi632.dtsi"
#include "X01AD-sdm632.dtsi"
#include "X01AD-sdm632-regulator.dtsi"
