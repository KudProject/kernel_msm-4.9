/* Copyright (c) 2015, The Linux Foundation. All rights reserved.
 *
 * This program is free software; you can redistribute it and/or modify
 * it under the terms of the GNU General Public License version 2 and
 * only version 2 as published by the Free Software Foundation.
 *
 * This program is distributed in the hope that it will be useful,
 * but WITHOUT ANY WARRANTY; without even the implied warranty of
 * MERCHANTABILITY or FITNESS FOR A PARTICULAR PURPOSE.  See the
 * GNU General Public License for more details.
 */

&mdss_mdp {
	dsi_ili7807d_djn_auo_37_1080p_video: qcom,mdss_dsi_ili7807d_djn_auo_37_1080p_video {
		qcom,mdss-dsi-panel-name = "ili7807d djn auo 37 1080p video mode dsi panel";
		qcom,mdss-dsi-panel-type = "dsi_video_mode";
		qcom,cont-splash-enabled;
		qcom,mdss-dsi-panel-framerate = <60>;
		qcom,mdss-dsi-virtual-channel-id = <0>;
		qcom,mdss-dsi-stream = <0>;
		qcom,mdss-dsi-panel-width = <1080>;
		qcom,mdss-dsi-panel-height = <1920>;
		qcom,mdss-dsi-h-front-porch = <260>;
		qcom,mdss-dsi-h-back-porch = <54>;
		qcom,mdss-dsi-h-pulse-width = <36>;
		qcom,mdss-dsi-h-sync-skew = <0>;
		qcom,mdss-dsi-v-front-porch = <8>;
		qcom,mdss-dsi-v-back-porch = <8>;
		qcom,mdss-dsi-v-pulse-width = <6>;
		qcom,mdss-dsi-h-left-border = <0>;
		qcom,mdss-dsi-h-right-border = <0>;
		qcom,mdss-dsi-v-top-border = <0>;
		qcom,mdss-dsi-v-bottom-border = <0>;
		qcom,mdss-dsi-bpp = <24>;
		qcom,mdss-dsi-underflow-color = <0xff>;
		qcom,mdss-dsi-border-color = <0>;
		qcom,mdss-dsi-h-sync-pulse = <0>;
		qcom,mdss-dsi-traffic-mode = "burst_mode";
		qcom,mdss-dsi-lane-map = "lane_map_0123";
		qcom,mdss-dsi-bllp-eof-power-mode;
		qcom,mdss-dsi-bllp-power-mode;
		qcom,mdss-dsi-lane-0-state;
		qcom,mdss-dsi-lane-1-state;
		qcom,mdss-dsi-lane-2-state;
		qcom,mdss-dsi-lane-3-state;
		qcom,mdss-dsi-panel-timings = [05 3e 2a 01 72 76 2e 42 32 03 04 00];
		qcom,mdss-dsi-t-clk-post = <0x02>;
		qcom,mdss-dsi-t-clk-pre = <0x2f>;
		qcom,mdss-dsi-bl-min-level = <1>;
		qcom,mdss-dsi-bl-max-level = <4095>;
		qcom,mdss-dsi-dma-trigger = "trigger_sw";
		qcom,mdss-dsi-mdp-trigger = "none";
		qcom,mdss-dsi-on-command = [
			// AUO H546DAN09.1 
			29 01 00 00 00 00 04  FF 78 07 01	//Page1
			29 01 00 00 00 00 02  42 11	//VGH=x4 VGL=x4
			29 01 00 00 00 00 02  43 A3	//VGH_CLP = 9.5V
			29 01 00 00 00 00 02  44 A8	//VGL_CLP = -9V
			29 01 00 00 00 00 02  45 19	//VGHO  = 8.5 V
			29 01 00 00 00 00 02  46 28	//VGLO  = -8.0V
			29 01 00 00 00 00 02  4A 12	//Disable VSPR 
			29 01 00 00 00 00 02  4B 12	//Disable VSNR 
			29 01 00 00 00 00 02  50 5A	//GVDDP  = 4.9V
			29 01 00 00 00 00 02  51 5A	//GVDDN  = -4.9V
			29 01 00 00 00 00 02  B3 70	//VGHO setting    
			29 01 00 00 00 00 02  B4 70	//VGLO setting 
			29 01 00 00 00 00 02  22 06	//SS&NW
			29 01 00 00 00 00 02  36 00        //2 mux 6
			29 01 00 00 00 00 02  63 04        //SDT
			29 01 00 00 00 00 02  64 08
			29 01 00 00 00 00 02  6C 45	//PRC & PRCB
			29 01 00 00 00 00 02  6D 00	//PCT2
			29 01 00 00 00 00 02  5A 33	//LVD setting
			29 01 00 00 00 00 04  FF 78 07 06	//Page6
			29 01 00 00 00 00 02  00 43    //  
			29 01 00 00 00 00 02  01 12    //	
			29 01 00 00 00 00 02  02 43    //jhc	
			29 01 00 00 00 00 02  03 43    //jhc	
			29 01 00 00 00 00 02  04 03    //	
			29 01 00 00 00 00 02  05 12    //	
			29 01 00 00 00 00 02  06 08    //	
			29 01 00 00 00 00 02  07 0A    //	
			29 01 00 00 00 00 02  08 83    //	
			29 01 00 00 00 00 02  09 02    //	
			29 01 00 00 00 00 02  0A 30    //	
			29 01 00 00 00 00 02  0B 10    //  
			29 01 00 00 00 00 02  0C 08    //	
			29 01 00 00 00 00 02  0D 08    //	
			29 01 00 00 00 00 02  0E 00    //	
			29 01 00 00 00 00 02  0F 00    //	
			29 01 00 00 00 00 02  10 00
			29 01 00 00 00 00 02  11 00
			29 01 00 00 00 00 02  12 00
			29 01 00 00 00 00 02  13 00
			29 01 00 00 00 00 02  14 84    // 
			29 01 00 00 00 00 02  15 84    // 
			29 01 00 00 00 00 02  31 08  // GOUTR_01_FW STV
			29 01 00 00 00 00 02  32 01  // GOUTR_02_FW U2D
			29 01 00 00 00 00 02  33 00  // GOUTR_03_FW D2U
			29 01 00 00 00 00 02  34 11  // GOUTR_04_FW CLK_L
			29 01 00 00 00 00 02  35 13  // GOUTR_05_FW XCLK_L
			29 01 00 00 00 00 02  36 26  // GOUTR_06_FW RST
			29 01 00 00 00 00 02  37 22  // GOUTR_07_FW XDONB = GAS
			29 01 00 00 00 00 02  38 02  // GOUTR_08_FW CTRL jhc
			29 01 00 00 00 00 02  39 0C  // GOUTR_09_FW V_END
			29 01 00 00 00 00 02  3A 02  // GOUTR_10_FW CTRL
			29 01 00 00 00 00 02  3B 02  // GOUTR_11_FW CTRL
			29 01 00 00 00 00 02  3C 02  // GOUTR_12_FW CTRL
			29 01 00 00 00 00 02  3D 02  // GOUTR_13_FW CTRL
			29 01 00 00 00 00 02  3E 28  // GOUTR_14_FW SWR
			29 01 00 00 00 00 02  3F 29  // GOUTR_15_FW SWG
			29 01 00 00 00 00 02  40 2A  // GOUTR_16_FW SWB
			29 01 00 00 00 00 02  41 08  // GOUTL_01_FW STV
			29 01 00 00 00 00 02  42 01  // GOUTL_02_FW U2D
			29 01 00 00 00 00 02  43 00  // GOUTL_03_FW D2U
			29 01 00 00 00 00 02  44 10  // GOUTL_04_FW CLK_R
			29 01 00 00 00 00 02  45 12  // GOUTL_05_FW XCLK_R
			29 01 00 00 00 00 02  46 26  // GOUTL_06_FW RST
			29 01 00 00 00 00 02  47 22  // GOUTL_07_FW XDONB = GAS
			29 01 00 00 00 00 02  48 02  // GOUTL_08_FW CTRL jhc
			29 01 00 00 00 00 02  49 0C  // GOUTL_09_FW V_END
			29 01 00 00 00 00 02  4A 02  // GOUTL_10_FW CTRL
			29 01 00 00 00 00 02  4B 02  // GOUTL_11_FW CTRL
			29 01 00 00 00 00 02  4C 02  // GOUTL_12_FW CTRL
			29 01 00 00 00 00 02  4D 02  // GOUTL_13_FW CTRL
			29 01 00 00 00 00 02  4E 28  // GOUTL_14_FW SWR
			29 01 00 00 00 00 02  4F 29  // GOUTL_15_FW SWG
			29 01 00 00 00 00 02  50 2A  // GOUTL_16_FW SWB
			29 01 00 00 00 00 02  61 0C  // GOUTR_01_BW STV
			29 01 00 00 00 00 02  62 01  // GOUTR_02_BW U2D
			29 01 00 00 00 00 02  63 00  // GOUTR_03_BW D2U
			29 01 00 00 00 00 02  64 12  // GOUTR_04_BW CLK_L
			29 01 00 00 00 00 02  65 10  // GOUTR_05_BW XCLK_L
			29 01 00 00 00 00 02  66 26  // GOUTR_06_BW RST
			29 01 00 00 00 00 02  67 22  // GOUTR_07_BW XCONB = GAS
			29 01 00 00 00 00 02  68 02  // GOUTR_08_BW CTRL jhc
			29 01 00 00 00 00 02  69 08  // GOUTR_09_BW V_END
			29 01 00 00 00 00 02  6A 02  // GOUTR_10_BW CTRL
			29 01 00 00 00 00 02  6B 02  // GOUTR_11_BW CTRL
			29 01 00 00 00 00 02  6C 02  // GOUTR_12_BW CTRL
			29 01 00 00 00 00 02  6D 02  // GOUTR_13_BW CTRL
			29 01 00 00 00 00 02  6E 28  // GOUTR_14_BW SWR
			29 01 00 00 00 00 02  6F 29  // GOUTR_15_BW SWG
			29 01 00 00 00 00 02  70 2A  // GOUTR_16_BW SWG
			29 01 00 00 00 00 02  71 0C  // GOUTL_01_BW STV
			29 01 00 00 00 00 02  72 01  // GOUTL_02_BW U2D
			29 01 00 00 00 00 02  73 00  // GOUTL_03_BW D2U
			29 01 00 00 00 00 02  74 13  // GOUTL_04_BW CLK_R
			29 01 00 00 00 00 02  75 11  // GOUTL_05_BW XCLK_R
			29 01 00 00 00 00 02  76 26  // GOUTL_06_BW RST
			29 01 00 00 00 00 02  77 22  // GOUTL_07_BW XDONB = GAS
			29 01 00 00 00 00 02  78 02  // GOUTL_08_BW CTRL jhc
			29 01 00 00 00 00 02  79 08  // GOUTL_09_BW V_END
			29 01 00 00 00 00 02  7A 02  // GOUTL_10_BW CRTL
			29 01 00 00 00 00 02  7B 02  // GOUTL_11_BW CTRL
			29 01 00 00 00 00 02  7C 02  // GOUTL_12_BW CTRL
			29 01 00 00 00 00 02  7D 02  // GOUTL_13_BW CTRL
			29 01 00 00 00 00 02  7E 28  // GOUTL_14_BW SWR
			29 01 00 00 00 00 02  7F 29  // GOUTL_15_BW SWG
			29 01 00 00 00 00 02  80 2A  // GOUTL_16_BW SWB
			29 01 00 00 00 00 02  D0 01
			29 01 00 00 00 00 02  D1 01
			29 01 00 00 00 00 02  D2 10   //jhc
			29 01 00 00 00 00 02  D3 00
			29 01 00 00 00 00 02  D4 00
			29 01 00 00 00 00 02  D5 00
			29 01 00 00 00 00 02  D6 00
			29 01 00 00 00 00 02  D7 00
			29 01 00 00 00 00 02  D8 00
			29 01 00 00 00 00 02  D9 00
			29 01 00 00 00 00 02  DA 00
			29 01 00 00 00 00 02  DB 47
			29 01 00 00 00 00 02  DC 02   //jhc
			29 01 00 00 00 00 02  DD 55
			29 01 00 00 00 00 02  96 80
			29 01 00 00 00 00 02  97 33   //jhc
			29 01 00 00 00 00 02  A0 10  //T8
			29 01 00 00 00 00 02  A1 00  //T7P  Pre-CKH
			29 01 00 00 00 00 02  A2 08  //T9P  T9= non overlap time
			29 01 00 00 00 00 02  A3 1E  //T7 = CHK width 1.9us
			29 01 00 00 00 00 02  A7 00
			29 01 00 00 00 00 02  A6 32
			29 01 00 00 00 00 02  A7 03
			29 01 00 00 00 00 02  AE 14
			29 01 00 00 00 00 02  E5 80
			29 01 00 00 00 00 02  B2 04
			29 01 00 00 00 00 02  B3 04
			29 01 00 00 00 00 04  FF 78 07 02				
			29 01 00 00 00 00 02 00 00	
			29 01 00 00 00 00 02 01 00	
			29 01 00 00 00 00 02 02 00	
			29 01 00 00 00 00 02 03 2B	
			29 01 00 00 00 00 02 04 00	
			29 01 00 00 00 00 02 05 64	
			29 01 00 00 00 00 02 06 00	
			29 01 00 00 00 00 02 07 8B	
			29 01 00 00 00 00 02 08 00	
			29 01 00 00 00 00 02 09 AA	
			29 01 00 00 00 00 02 0A 00	
			29 01 00 00 00 00 02 0B C4	
			29 01 00 00 00 00 02 0C 00	
			29 01 00 00 00 00 02 0D D9	
			29 01 00 00 00 00 02 0E 00	
			29 01 00 00 00 00 02 0F EC	
			29 01 00 00 00 00 02 10 00	
			29 01 00 00 00 00 02 11 FD	
			29 01 00 00 00 00 02 12 01	
			29 01 00 00 00 00 02 13 33	
			29 01 00 00 00 00 02 14 01	
			29 01 00 00 00 00 02 15 5A	
			29 01 00 00 00 00 02 16 01	
			29 01 00 00 00 00 02 17 93	
			29 01 00 00 00 00 02 18 01	
			29 01 00 00 00 00 02 19 BE	
			29 01 00 00 00 00 02 1A 01	
			29 01 00 00 00 00 02 1B FA	
			29 01 00 00 00 00 02 1C 02	
			29 01 00 00 00 00 02 1D 2A	
			29 01 00 00 00 00 02 1E 02	
			29 01 00 00 00 00 02 1F 2B	
			29 01 00 00 00 00 02 20 02	
			29 01 00 00 00 00 02 21 58	
			29 01 00 00 00 00 02 22 02	
			29 01 00 00 00 00 02 23 8F	
			29 01 00 00 00 00 02 24 02	
			29 01 00 00 00 00 02 25 B6	
			29 01 00 00 00 00 02 26 02	
			29 01 00 00 00 00 02 27 EC	
			29 01 00 00 00 00 02 28 03	
			29 01 00 00 00 00 02 29 10	
			29 01 00 00 00 00 02 2A 03	
			29 01 00 00 00 00 02 2B 3D	
			29 01 00 00 00 00 02 2C 03	
			29 01 00 00 00 00 02 2D 4B	
			29 01 00 00 00 00 02 2E 03	
			29 01 00 00 00 00 02 2F 5A	
			29 01 00 00 00 00 02 30 03	
			29 01 00 00 00 00 02 31 6B	
			29 01 00 00 00 00 02 32 03	
			29 01 00 00 00 00 02 33 7E	
			29 01 00 00 00 00 02 34 03	
			29 01 00 00 00 00 02 35 94	
			29 01 00 00 00 00 02 36 03	
			29 01 00 00 00 00 02 37 B1	
			29 01 00 00 00 00 02 38 03	
			29 01 00 00 00 00 02 39 D4	
			29 01 00 00 00 00 02 3A 03	
			29 01 00 00 00 00 02 3B E6	
			29 01 00 00 00 00 02 3C 00	
			29 01 00 00 00 00 02 3D 00	
			29 01 00 00 00 00 02 3E 00	
			29 01 00 00 00 00 02 3F 2B	
			29 01 00 00 00 00 02 40 00	
			29 01 00 00 00 00 02 41 64	
			29 01 00 00 00 00 02 42 00	
			29 01 00 00 00 00 02 43 8B	
			29 01 00 00 00 00 02 44 00	
			29 01 00 00 00 00 02 45 AA	
			29 01 00 00 00 00 02 46 00	
			29 01 00 00 00 00 02 47 C9	
			29 01 00 00 00 00 02 48 00	
			29 01 00 00 00 00 02 49 E4	
			29 01 00 00 00 00 02 4A 00	
			29 01 00 00 00 00 02 4B F5	
			29 01 00 00 00 00 02 4C 01	
			29 01 00 00 00 00 02 4D 01	
			29 01 00 00 00 00 02 4E 01	
			29 01 00 00 00 00 02 4F 33	
			29 01 00 00 00 00 02 50 01	
			29 01 00 00 00 00 02 51 5A	
			29 01 00 00 00 00 02 52 01	
			29 01 00 00 00 00 02 53 93	
			29 01 00 00 00 00 02 54 01	
			29 01 00 00 00 00 02 55 BE	
			29 01 00 00 00 00 02 56 01	
			29 01 00 00 00 00 02 57 FA	
			29 01 00 00 00 00 02 58 02	
			29 01 00 00 00 00 02 59 2A	
			29 01 00 00 00 00 02 5A 02	
			29 01 00 00 00 00 02 5B 2B	
			29 01 00 00 00 00 02 5C 02	
			29 01 00 00 00 00 02 5D 58	
			29 01 00 00 00 00 02 5E 02	
			29 01 00 00 00 00 02 5F 8F	
			29 01 00 00 00 00 02 60 02	
			29 01 00 00 00 00 02 61 B6	
			29 01 00 00 00 00 02 62 02	
			29 01 00 00 00 00 02 63 EC	
			29 01 00 00 00 00 02 64 03	
			29 01 00 00 00 00 02 65 10	
			29 01 00 00 00 00 02 66 03	
			29 01 00 00 00 00 02 67 3D	
			29 01 00 00 00 00 02 68 03	
			29 01 00 00 00 00 02 69 4B	
			29 01 00 00 00 00 02 6A 03	
			29 01 00 00 00 00 02 6B 5A	
			29 01 00 00 00 00 02 6C 03	
			29 01 00 00 00 00 02 6D 6B	
			29 01 00 00 00 00 02 6E 03	
			29 01 00 00 00 00 02 6F 7E	
			29 01 00 00 00 00 02 70 03	
			29 01 00 00 00 00 02 71 94	
			29 01 00 00 00 00 02 72 03	
			29 01 00 00 00 00 02 73 B1	
			29 01 00 00 00 00 02 74 03	
			29 01 00 00 00 00 02 75 D4	
			29 01 00 00 00 00 02 76 03	
			29 01 00 00 00 00 02 77 E6				
			29 01 00 00 00 00 02  78 01    				
			29 01 00 00 00 00 02  79 01    				
			29 01 00 00 00 00 04  FF 78 07 03				
			29 01 00 00 00 00 02 00 00	
			29 01 00 00 00 00 02 01 00	
			29 01 00 00 00 00 02 02 00	
			29 01 00 00 00 00 02 03 27	
			29 01 00 00 00 00 02 04 00	
			29 01 00 00 00 00 02 05 62	
			29 01 00 00 00 00 02 06 00	
			29 01 00 00 00 00 02 07 8B	
			29 01 00 00 00 00 02 08 00	
			29 01 00 00 00 00 02 09 AA	
			29 01 00 00 00 00 02 0A 00	
			29 01 00 00 00 00 02 0B C4	
			29 01 00 00 00 00 02 0C 00	
			29 01 00 00 00 00 02 0D D9	
			29 01 00 00 00 00 02 0E 00	
			29 01 00 00 00 00 02 0F EC	
			29 01 00 00 00 00 02 10 00	
			29 01 00 00 00 00 02 11 FD	
			29 01 00 00 00 00 02 12 01	
			29 01 00 00 00 00 02 13 33	
			29 01 00 00 00 00 02 14 01	
			29 01 00 00 00 00 02 15 5A	
			29 01 00 00 00 00 02 16 01	
			29 01 00 00 00 00 02 17 93	
			29 01 00 00 00 00 02 18 01	
			29 01 00 00 00 00 02 19 BE	
			29 01 00 00 00 00 02 1A 01	
			29 01 00 00 00 00 02 1B FA	
			29 01 00 00 00 00 02 1C 02	
			29 01 00 00 00 00 02 1D 2A	
			29 01 00 00 00 00 02 1E 02	
			29 01 00 00 00 00 02 1F 2B	
			29 01 00 00 00 00 02 20 02	
			29 01 00 00 00 00 02 21 58	
			29 01 00 00 00 00 02 22 02	
			29 01 00 00 00 00 02 23 8F	
			29 01 00 00 00 00 02 24 02	
			29 01 00 00 00 00 02 25 B6	
			29 01 00 00 00 00 02 26 02	
			29 01 00 00 00 00 02 27 EC	
			29 01 00 00 00 00 02 28 03	
			29 01 00 00 00 00 02 29 10	
			29 01 00 00 00 00 02 2A 03	
			29 01 00 00 00 00 02 2B 3D	
			29 01 00 00 00 00 02 2C 03	
			29 01 00 00 00 00 02 2D 4B	
			29 01 00 00 00 00 02 2E 03	
			29 01 00 00 00 00 02 2F 5A	
			29 01 00 00 00 00 02 30 03	
			29 01 00 00 00 00 02 31 6B	
			29 01 00 00 00 00 02 32 03	
			29 01 00 00 00 00 02 33 7E	
			29 01 00 00 00 00 02 34 03	
			29 01 00 00 00 00 02 35 94	
			29 01 00 00 00 00 02 36 03	
			29 01 00 00 00 00 02 37 B1	
			29 01 00 00 00 00 02 38 03	
			29 01 00 00 00 00 02 39 D4	
			29 01 00 00 00 00 02 3A 03	
			29 01 00 00 00 00 02 3B E6	
			29 01 00 00 00 00 02 3C 00	
			29 01 00 00 00 00 02 3D 00	
			29 01 00 00 00 00 02 3E 00	
			29 01 00 00 00 00 02 3F 27	
			29 01 00 00 00 00 02 40 00	
			29 01 00 00 00 00 02 41 62	
			29 01 00 00 00 00 02 42 00	
			29 01 00 00 00 00 02 43 8B	
			29 01 00 00 00 00 02 44 00	
			29 01 00 00 00 00 02 45 AA	
			29 01 00 00 00 00 02 46 00	
			29 01 00 00 00 00 02 47 C9	
			29 01 00 00 00 00 02 48 00	
			29 01 00 00 00 00 02 49 E4	
			29 01 00 00 00 00 02 4A 00	
			29 01 00 00 00 00 02 4B F5	
			29 01 00 00 00 00 02 4C 01	
			29 01 00 00 00 00 02 4D 01	
			29 01 00 00 00 00 02 4E 01	
			29 01 00 00 00 00 02 4F 33	
			29 01 00 00 00 00 02 50 01	
			29 01 00 00 00 00 02 51 5A	
			29 01 00 00 00 00 02 52 01	
			29 01 00 00 00 00 02 53 93	
			29 01 00 00 00 00 02 54 01	
			29 01 00 00 00 00 02 55 BE	
			29 01 00 00 00 00 02 56 01	
			29 01 00 00 00 00 02 57 FA	
			29 01 00 00 00 00 02 58 02	
			29 01 00 00 00 00 02 59 2A	
			29 01 00 00 00 00 02 5A 02	
			29 01 00 00 00 00 02 5B 2B	
			29 01 00 00 00 00 02 5C 02	
			29 01 00 00 00 00 02 5D 58	
			29 01 00 00 00 00 02 5E 02	
			29 01 00 00 00 00 02 5F 8F	
			29 01 00 00 00 00 02 60 02	
			29 01 00 00 00 00 02 61 B6	
			29 01 00 00 00 00 02 62 02	
			29 01 00 00 00 00 02 63 EC	
			29 01 00 00 00 00 02 64 03	
			29 01 00 00 00 00 02 65 10	
			29 01 00 00 00 00 02 66 03	
			29 01 00 00 00 00 02 67 3D	
			29 01 00 00 00 00 02 68 03	
			29 01 00 00 00 00 02 69 4B	
			29 01 00 00 00 00 02 6A 03	
			29 01 00 00 00 00 02 6B 5A	
			29 01 00 00 00 00 02 6C 03	
			29 01 00 00 00 00 02 6D 6B	
			29 01 00 00 00 00 02 6E 03	
			29 01 00 00 00 00 02 6F 7E	
			29 01 00 00 00 00 02 70 03	
			29 01 00 00 00 00 02 71 94	
			29 01 00 00 00 00 02 72 03	
			29 01 00 00 00 00 02 73 B1	
			29 01 00 00 00 00 02 74 03	
			29 01 00 00 00 00 02 75 D4	
			29 01 00 00 00 00 02 76 03	
			29 01 00 00 00 00 02 77 E6		
			29 01 00 00 00 00 02  78 01    				
			29 01 00 00 00 00 02  79 01    				
			29 01 00 00 00 00 04  FF 78 07 04				
29 01 00 00 00 00 02 00 00	
29 01 00 00 00 00 02 01 B4	
29 01 00 00 00 00 02 02 00	
29 01 00 00 00 00 02 03 C2	
29 01 00 00 00 00 02 04 00	
29 01 00 00 00 00 02 05 D9	
29 01 00 00 00 00 02 06 00	
29 01 00 00 00 00 02 07 EE	
29 01 00 00 00 00 02 08 00	
29 01 00 00 00 00 02 09 FF	
29 01 00 00 00 00 02 0A 01	
29 01 00 00 00 00 02 0B 0F	
29 01 00 00 00 00 02 0C 01	
29 01 00 00 00 00 02 0D 1D	
29 01 00 00 00 00 02 0E 01	
29 01 00 00 00 00 02 0F 2A	
29 01 00 00 00 00 02 10 01	
29 01 00 00 00 00 02 11 36	
29 01 00 00 00 00 02 12 01	
29 01 00 00 00 00 02 13 5D	
29 01 00 00 00 00 02 14 01	
29 01 00 00 00 00 02 15 7B	
29 01 00 00 00 00 02 16 01	
29 01 00 00 00 00 02 17 AB	
29 01 00 00 00 00 02 18 01	
29 01 00 00 00 00 02 19 CF	
29 01 00 00 00 00 02 1A 02	
29 01 00 00 00 00 02 1B 05	
29 01 00 00 00 00 02 1C 02	
29 01 00 00 00 00 02 1D 31	
29 01 00 00 00 00 02 1E 02	
29 01 00 00 00 00 02 1F 32	
29 01 00 00 00 00 02 20 02	
29 01 00 00 00 00 02 21 5E	
29 01 00 00 00 00 02 22 02	
29 01 00 00 00 00 02 23 95	
29 01 00 00 00 00 02 24 02	
29 01 00 00 00 00 02 25 BC	
29 01 00 00 00 00 02 26 02	
29 01 00 00 00 00 02 27 F3	
29 01 00 00 00 00 02 28 03	
29 01 00 00 00 00 02 29 19	
29 01 00 00 00 00 02 2A 03	
29 01 00 00 00 00 02 2B 4C	
29 01 00 00 00 00 02 2C 03	
29 01 00 00 00 00 02 2D 5D	
29 01 00 00 00 00 02 2E 03	
29 01 00 00 00 00 02 2F 6F	
29 01 00 00 00 00 02 30 03	
29 01 00 00 00 00 02 31 7D	
29 01 00 00 00 00 02 32 03	
29 01 00 00 00 00 02 33 8E	
29 01 00 00 00 00 02 34 03	
29 01 00 00 00 00 02 35 A0	
29 01 00 00 00 00 02 36 03	
29 01 00 00 00 00 02 37 BC	
29 01 00 00 00 00 02 38 03	
29 01 00 00 00 00 02 39 D8	
29 01 00 00 00 00 02 3A 03	
29 01 00 00 00 00 02 3B E6	
29 01 00 00 00 00 02 3C 00	
29 01 00 00 00 00 02 3D B5	
29 01 00 00 00 00 02 3E 00	
29 01 00 00 00 00 02 3F C7	
29 01 00 00 00 00 02 40 00	
29 01 00 00 00 00 02 41 E4	
29 01 00 00 00 00 02 42 00	
29 01 00 00 00 00 02 43 F6	
29 01 00 00 00 00 02 44 01	
29 01 00 00 00 00 02 45 02	
29 01 00 00 00 00 02 46 01	
29 01 00 00 00 00 02 47 0F	
29 01 00 00 00 00 02 48 01	
29 01 00 00 00 00 02 49 1D	
29 01 00 00 00 00 02 4A 01	
29 01 00 00 00 00 02 4B 2A	
29 01 00 00 00 00 02 4C 01	
29 01 00 00 00 00 02 4D 36	
29 01 00 00 00 00 02 4E 01	
29 01 00 00 00 00 02 4F 5D	
29 01 00 00 00 00 02 50 01	
29 01 00 00 00 00 02 51 7B	
29 01 00 00 00 00 02 52 01	
29 01 00 00 00 00 02 53 AB	
29 01 00 00 00 00 02 54 01	
29 01 00 00 00 00 02 55 CF	
29 01 00 00 00 00 02 56 02	
29 01 00 00 00 00 02 57 05	
29 01 00 00 00 00 02 58 02	
29 01 00 00 00 00 02 59 31	
29 01 00 00 00 00 02 5A 02	
29 01 00 00 00 00 02 5B 32	
29 01 00 00 00 00 02 5C 02	
29 01 00 00 00 00 02 5D 5E	
29 01 00 00 00 00 02 5E 02	
29 01 00 00 00 00 02 5F 95	
29 01 00 00 00 00 02 60 02	
29 01 00 00 00 00 02 61 BC	
29 01 00 00 00 00 02 62 02	
29 01 00 00 00 00 02 63 F3	
29 01 00 00 00 00 02 64 03	
29 01 00 00 00 00 02 65 19	
29 01 00 00 00 00 02 66 03	
29 01 00 00 00 00 02 67 4C	
29 01 00 00 00 00 02 68 03	
29 01 00 00 00 00 02 69 5D	
29 01 00 00 00 00 02 6A 03	
29 01 00 00 00 00 02 6B 6F	
29 01 00 00 00 00 02 6C 03	
29 01 00 00 00 00 02 6D 7D	
29 01 00 00 00 00 02 6E 03	
29 01 00 00 00 00 02 6F 8E	
29 01 00 00 00 00 02 70 03	
29 01 00 00 00 00 02 71 A0	
29 01 00 00 00 00 02 72 03	
29 01 00 00 00 00 02 73 BC	
29 01 00 00 00 00 02 74 03	
29 01 00 00 00 00 02 75 D8	
29 01 00 00 00 00 02 76 03	
			29 01 00 00 00 00 02  77 E6    //0				
			29 01 00 00 00 00 02  78 01				
			29 01 00 00 00 00 02  79 01					
			29 01 00 00 00 00 04  FF 78 07 00    	//Page0
			29 01 00 00 00 00 02  35 00 	
			05 01 00 00 78 00 02  11 00
			05 01 00 00 14 00 02  29 00
		];
		qcom,mdss-dsi-off-command = [05 01 00 00 32 00 02 28 00
					                 05 01 00 00 10 00 02 10 00
		];

		qcom,mdss-dsi-hfp-power-mode;
		
		qcom,mdss-dsi-on-command-state = "dsi_lp_mode";
		qcom,mdss-dsi-off-command-state = "dsi_lp_mode";

		qcom,mdss-dsi-bl-pmic-control-type = "bl_ctrl_wled";
		qcom,mdss-dsi-reset-sequence = <1 20>, <0 20>, <1 50>;
		qcom,mdss-dsi-tx-eot-append;
		qcom,panel-supply-entries = <&dsi_panel_pwr_supply>;

		qcom,mdss-dsi-panel-status-command = [06 01 00 01 05 00 02 0A 08
											  06 01 00 01 05 00 02 0B 08
											  06 01 00 01 05 00 02 0D 08];
		qcom,mdss-dsi-panel-status-command-state = "dsi_lp_mode";
		qcom,mdss-dsi-panel-status-check-mode = "reg_read";
		qcom,mdss-dsi-panel-status-read-length = <4 4 4>;
		qcom,mdss-dsi-panel-status-valid-params = <1 1 1> ;
		qcom,mdss-dsi-panel-status-value = <0x9c 0x00 0x00>;
		qcom,esd-check-enabled;
		qcom,mdss-dsi-post-init-delay = <1>;
		qcom,mdss-dsi-lp11-init;
	};
};
