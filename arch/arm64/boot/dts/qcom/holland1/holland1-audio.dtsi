/* Copyright (c) 2020, The Linux Foundation. All rights reserved.
*  Copyright (c) 2020, Jebaitedneko.
*
* This program is free software; you can redistribute it and/or modify
* it under the terms of the GNU General Public License version 2 and
* only version 2 as published by the Free Software Foundation.
*
* This program is distributed in the hope that it will be useful,
* but WITHOUT ANY WARRANTY; without even the implied warranty of
* MERCHANTABILITY or FITNESS FOR A PARTICULAR PURPOSE.  See the
* GNU General Public License for more details.
*/

&int_codec {

	qcom,model = "msm8952-sku2-snd-card";
	qcom,msm-ext-pa = "primary";
	qcom,msm-spk-ext-pa = <&tlmm 68 0>;
	qcom,msm-mbhc-hphl-swh = <1>;
	qcom,msm-mclk-freq = <9600000>;
	qcom,msm-hs-micbias-type = "external";
	qcom,msm-micbias1-ext-cap;
	qcom,audio-routing =
			"RX_BIAS", "MCLK",
			"SPK_RX_BIAS", "MCLK",
			"INT_LDO_H", "MCLK",
			"MIC BIAS External", "Handset Mic",
			"MIC BIAS External2", "Headset Mic",
			"MIC BIAS External", "Secondary Mic",
			"AMIC1", "MIC BIAS External",
			"AMIC2", "MIC BIAS External2",
			"AMIC3", "MIC BIAS External";

	/delete-property/ qcom,cdc-us-euro-gpios;
};
