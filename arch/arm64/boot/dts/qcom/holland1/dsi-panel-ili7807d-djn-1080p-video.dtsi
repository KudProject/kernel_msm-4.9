/* Copyright (c) 2015, The Linux Foundation. All rights reserved.
 *
 * This program is free software; you can redistribute it and/or modify
 * it under the terms of the GNU General Public License version 2 and
 * only version 2 as published by the Free Software Foundation.
 *
 * This program is distributed in the hope that it will be useful,
 * but WITHOUT ANY WARRANTY; without even the implied warranty of
 * MERCHANTABILITY or FITNESS FOR A PARTICULAR PURPOSE.  See the
 * GNU General Public License for more details.
 */

&mdss_mdp {
	dsi_ili7807d_djn_1080p_video: qcom,mdss_dsi_ili7807d_djn_1080p_video {
		qcom,mdss-dsi-panel-name = "ili7807d djn 1080p video mode dsi panel";
		qcom,mdss-dsi-panel-type = "dsi_video_mode";
		qcom,cont-splash-enabled;
		qcom,mdss-dsi-panel-framerate = <60>;
		qcom,mdss-dsi-virtual-channel-id = <0>;
		qcom,mdss-dsi-stream = <0>;
		qcom,mdss-dsi-panel-width = <1080>;
		qcom,mdss-dsi-panel-height = <1920>;
		qcom,mdss-dsi-h-front-porch = <260>;
		qcom,mdss-dsi-h-back-porch = <54>;
		qcom,mdss-dsi-h-pulse-width = <36>;
		qcom,mdss-dsi-h-sync-skew = <0>;
		qcom,mdss-dsi-v-front-porch = <8>;
		qcom,mdss-dsi-v-back-porch = <8>;
		qcom,mdss-dsi-v-pulse-width = <6>;
		qcom,mdss-dsi-h-left-border = <0>;
		qcom,mdss-dsi-h-right-border = <0>;
		qcom,mdss-dsi-v-top-border = <0>;
		qcom,mdss-dsi-v-bottom-border = <0>;
		qcom,mdss-dsi-bpp = <24>;
		qcom,mdss-dsi-underflow-color = <0xff>;
		qcom,mdss-dsi-border-color = <0>;
		qcom,mdss-dsi-h-sync-pulse = <0>;
		qcom,mdss-dsi-traffic-mode = "burst_mode";
		qcom,mdss-dsi-lane-map = "lane_map_0123";
		qcom,mdss-dsi-bllp-eof-power-mode;
		qcom,mdss-dsi-bllp-power-mode;
		qcom,mdss-dsi-lane-0-state;
		qcom,mdss-dsi-lane-1-state;
		qcom,mdss-dsi-lane-2-state;
		qcom,mdss-dsi-lane-3-state;
		qcom,mdss-dsi-panel-timings = [05 3e 2a 01 72 76 2e 42 32 03 04 00];
		qcom,mdss-dsi-t-clk-post = <0x02>;
		qcom,mdss-dsi-t-clk-pre = <0x2f>;
		qcom,mdss-dsi-bl-min-level = <1>;
		qcom,mdss-dsi-bl-max-level = <4095>;
		qcom,mdss-dsi-dma-trigger = "trigger_sw";
		qcom,mdss-dsi-mdp-trigger = "none";
		qcom,mdss-dsi-on-command = [
			29 01 00 00 00 00 04  FF 78 07 01 	//Page1
			//29 01 00 00 00 00 02  58 01 
			29 01 00 00 00 00 02  42 11    //VGH=x4 VGL=x4
			29 01 00 00 00 00 02  43 A3    //VGH_CLP = 9.5V
			29 01 00 00 00 00 02  44 9E    //VGL_CLP = -8.0V
			29 01 00 00 00 00 02  45 18    //VGHO = 8.4V
			29 01 00 00 00 00 02  46 16    //VGLO = -6.2V
			29 01 00 00 00 00 02  4A 12    //Disable VSPR = 4.7V
			29 01 00 00 00 00 02  4B 12    //Disable VSNR = - 4.7V
			29 01 00 00 00 00 02  50 37    //GVDDP =  4.1V
			29 01 00 00 00 00 02  51 37    //GVDDN = -4.1V
			29 01 00 00 00 00 02  57 89    //LVD for 3 power GAS function
			29 01 00 00 00 00 02  5A 33         // jhc                        
			29 01 00 00 00 00 02  B3 70         //jhc
			29 01 00 00 00 00 02  B4 70         //jhc
			29 01 00 00 00 00 02  22 06    //SS&NW  jhc 
			29 01 00 00 00 00 02  36 00    //2to6 sub-pixel column
			29 01 00 00 00 00 02  6C 45    //PRC & PRCB
			29 01 00 00 00 00 04  FF 78 07 06    //Page6
			29 01 00 00 00 00 02  00 41    //STVA setting
			29 01 00 00 00 00 02  01 14    //STVA setting
			29 01 00 00 00 00 02  02 08    //FTI_A_Rise   jhc
			29 01 00 00 00 00 02  03 86    //FTI_A_Fall   jhc
			29 01 00 00 00 00 02  04 00    //STVB setting
			29 01 00 00 00 00 02  05 00    //STVB setting
			29 01 00 00 00 00 02  06 00    //FTI_B_Rise
			29 01 00 00 00 00 02  07 00    //FTI_B_Fall
			29 01 00 00 00 00 02  08 81 
			29 01 00 00 00 00 02  09 00    // clock falling  4 dummy
			29 01 00 00 00 00 02  0A 30    // Phase clock = 4 ; Overlap  = 0 (1H)
			29 01 00 00 00 00 02  0B 31 
			29 01 00 00 00 00 02  0C 08    //CLW_A1_Rise  04   jhc
			29 01 00 00 00 00 02  0D 08    //CLW_A2_Rise  04   jhc
			29 01 00 00 00 00 02  0E 78    //CLW_A1_Fall  3a   jhc
			29 01 00 00 00 00 02  0F 78    //CLW_A2_Fall  3a   jhc
			29 01 00 00 00 00 02  10 00 
			29 01 00 00 00 00 02  11 00 
			29 01 00 00 00 00 02  12 00 
			29 01 00 00 00 00 02  13 00 
			29 01 00 00 00 00 02  14 00 
			29 01 00 00 00 00 02  15 00 
			29 01 00 00 00 00 02  31 07    // GOUTR_01_FW
			29 01 00 00 00 00 02  32 13    // GOUTR_02_FW CLK2
			29 01 00 00 00 00 02  33 11    // GOUTR_03_FW CLK4
			29 01 00 00 00 00 02  34 07    // GOUTR_04_FW 
			29 01 00 00 00 00 02  35 07    // GOUTR_05_FW
			29 01 00 00 00 00 02  36 07    // GOUTR_06_FW
			29 01 00 00 00 00 02  37 26    // GOUTR_07_FW INIT(RESET)
			29 01 00 00 00 00 02  38 09    // GOUTR_08_FW GSPL
			29 01 00 00 00 00 02  39 22    // GOUTR_09_FW AON (GAS)
			29 01 00 00 00 00 02  3A 23    // GOUTR_10_FW AONB(GASB)
			29 01 00 00 00 00 02  3B 07    // GOUTR_11_FW
			29 01 00 00 00 00 02  3C 07    // GOUTR_12_FW
			29 01 00 00 00 00 02  3D 07    // GOUTR_13_FW
			29 01 00 00 00 00 02  3E 2a    // GOUTR_14_FW BSWL
			29 01 00 00 00 00 02  3F 29    // GOUTR_15_FW GSWL
			29 01 00 00 00 00 02  40 28    // GOUTR_16_FW RSLW
			29 01 00 00 00 00 02  41 07    // GOUTL_01_FW 
			29 01 00 00 00 00 02  42 12    // GOUTL_02_FW CLK1
			29 01 00 00 00 00 02  43 10    // GOUTL_03_FW CLK3
			29 01 00 00 00 00 02  44 07    // GOUTL_04_FW
			29 01 00 00 00 00 02  45 07    // GOUTL_05_FW
			29 01 00 00 00 00 02  46 01    // GOUTL_06_FW UD
			29 01 00 00 00 00 02  47 00    // GOUTL_07_FW UDB
			29 01 00 00 00 00 02  48 08    // GOUTL_08_FW GSPR
			29 01 00 00 00 00 02  49 07    // GOUTL_09_FW
			29 01 00 00 00 00 02  4A 07    // GOUTL_10_FW
			29 01 00 00 00 00 02  4B 07    // GOUTL_11_FW
			29 01 00 00 00 00 02  4C 07    // GOUTL_12_FW
			29 01 00 00 00 00 02  4D 07    // GOUTL_13_FW
			29 01 00 00 00 00 02  4E 2a    // GOUTL_14_FW BSWR
			29 01 00 00 00 00 02  4F 29    // GOUTL_15_FW GSWR
			29 01 00 00 00 00 02  50 28    // GOUTL_16_FW RSWR
			29 01 00 00 00 00 02  61 07    // GOUTR_01_BW
			29 01 00 00 00 00 02  62 10    // GOUTR_02_BW CLK2
			29 01 00 00 00 00 02  63 12    // GOUTR_03_BW CLK4
			29 01 00 00 00 00 02  64 07    // GOUTR_04_BW
			29 01 00 00 00 00 02  65 07    // GOUTR_05_BW
			29 01 00 00 00 00 02  66 07    // GOUTR_06_BW
			29 01 00 00 00 00 02  67 26    // GOUTR_07_BW INIT(RESET)
			29 01 00 00 00 00 02  68 08    // GOUTR_08_BW GSPL
			29 01 00 00 00 00 02  69 22    // GOUTR_09_BW AON (GAS)
			29 01 00 00 00 00 02  6A 23    // GOUTR_10_BW AONB(GASB)
			29 01 00 00 00 00 02  6B 07    // GOUTR_11_BW
			29 01 00 00 00 00 02  6C 07    // GOUTR_12_BW
			29 01 00 00 00 00 02  6D 07    // GOUTR_13_BW
			29 01 00 00 00 00 02  6E 2a    // GOUTR_14_BW RSWL
			29 01 00 00 00 00 02  6F 29    // GOUTR_15_BW GSWL
			29 01 00 00 00 00 02  70 28    // GOUTR_16_BW BSLW
			29 01 00 00 00 00 02  71 07    // GOUTL_01_BW
			29 01 00 00 00 00 02  72 11    // GOUTL_02_BW CLK1
			29 01 00 00 00 00 02  73 13    // GOUTL_03_BW CLK3
			29 01 00 00 00 00 02  74 07    // GOUTL_04_BW
			29 01 00 00 00 00 02  75 07    // GOUTL_05_BW
			29 01 00 00 00 00 02  76 01    // GOUTL_06_BW UD
			29 01 00 00 00 00 02  77 00    // GOUTL_07_BW UDB
			29 01 00 00 00 00 02  78 09    // GOUTL_08_BW GSPR
			29 01 00 00 00 00 02  79 07    // GOUTL_09_BW
			29 01 00 00 00 00 02  7A 07    // GOUTL_10_BW
			29 01 00 00 00 00 02  7B 07    // GOUTL_11_BW
			29 01 00 00 00 00 02  7C 07    // GOUTL_12_BW
			29 01 00 00 00 00 02  7D 07    // GOUTL_13_BW
			29 01 00 00 00 00 02  7E 2a    // GOUTL_14_BW RSWR
			29 01 00 00 00 00 02  7F 29    // GOUTL_15_BW GSWR
			29 01 00 00 00 00 02  80 28    // GOUTL_16_BW BSWR
			29 01 00 00 00 00 02  96 80 
			29 01 00 00 00 00 02  97 22 
			29 01 00 00 00 00 02  A0 0A    //jhc
			29 01 00 00 00 00 02  A1 00 
			29 01 00 00 00 00 02  A2 0A    //05 jhc
			29 01 00 00 00 00 02  A3 1C    //0e jhc
			29 01 00 00 00 00 02  A7 80 
			29 01 00 00 00 00 02  D0 01    // GAS function on
			29 01 00 00 00 00 02  D1 11 
			29 01 00 00 00 00 02  DA 04 
			29 01 00 00 00 00 02  D3 31    // CLK_a_onseq_ext_region2[D4]  / STV_a_onseq_ext_region2[D0]
			29 01 00 00 00 00 02  D4 10    // CKH_onseq_ext_region2[D5-D4]
			29 01 00 00 00 00 02  D5 00    // Gas_onseq_ext_region2[D2]    / fwbw_onseq_ext_region2[D1-0]
			29 01 00 00 00 00 02  E5 18 
			29 01 00 00 00 00 02  DB 00    //jhc
			29 01 00 00 00 00 02  DD 00    //jhc 
			29 01 00 00 00 00 02  B2 00    //jhc
			29 01 00 00 00 00 02  B3 00    //jhc
29 01 00 00 00 00 04 FF 78 07 02							
			29 01 00 00 00 00 02 00 00    //255			
			29 01 00 00 00 00 02 01 9B    //255			
			29 01 00 00 00 00 02 02 00    //254			
			29 01 00 00 00 00 02 03 A7    //254			
			29 01 00 00 00 00 02 04 00    //252			
			29 01 00 00 00 00 02 05 BB    //252			
			29 01 00 00 00 00 02 06 00    //250			
			29 01 00 00 00 00 02 07 CE    //250			
			29 01 00 00 00 00 02 08 00    //248			
			29 01 00 00 00 00 02 09 DE    //248			
			29 01 00 00 00 00 02 0A 00    //246			
			29 01 00 00 00 00 02 0B EC    //246			
			29 01 00 00 00 00 02 0C 00    //244			
			29 01 00 00 00 00 02 0D F9    //244			
			29 01 00 00 00 00 02 0E 01    //242			
			29 01 00 00 00 00 02 0F 06    //242			
			29 01 00 00 00 00 02 10 01    //240			
			29 01 00 00 00 00 02 11 11    //240			
			29 01 00 00 00 00 02 12 01    //232			
			29 01 00 00 00 00 02 13 38    //232			
			29 01 00 00 00 00 02 14 01    //224			
			29 01 00 00 00 00 02 15 57    //224			
			29 01 00 00 00 00 02 16 01    //208			
			29 01 00 00 00 00 02 17 8A    //208			
			29 01 00 00 00 00 02 18 01    //192			
			29 01 00 00 00 00 02 19 B4    //192			
			29 01 00 00 00 00 02 1A 01    //160			
			29 01 00 00 00 00 02 1B F6    //160			
			29 01 00 00 00 00 02 1C 02    //128			
			29 01 00 00 00 00 02 1D 2B    //128			
			29 01 00 00 00 00 02 1E 02    //127			
			29 01 00 00 00 00 02 1F 2C    //127			
			29 01 00 00 00 00 02 20 02    //95			
			29 01 00 00 00 00 02 21 5C    //95			
			29 01 00 00 00 00 02 22 02    //63			
			29 01 00 00 00 00 02 23 90    //63			
			29 01 00 00 00 00 02 24 02    //47			
			29 01 00 00 00 00 02 25 B2    //47			
			29 01 00 00 00 00 02 26 02    //31			
			29 01 00 00 00 00 02 27 E2    //31			
			29 01 00 00 00 00 02 28 03    //23			
			29 01 00 00 00 00 02 29 04    //23			
			29 01 00 00 00 00 02 2A 03    //15			
			29 01 00 00 00 00 02 2B 31    //15			
			29 01 00 00 00 00 02 2C 03    //13			
			29 01 00 00 00 00 02 2D 3E    //13			
			29 01 00 00 00 00 02 2E 03    //11			
			29 01 00 00 00 00 02 2F 4D    //11			
			29 01 00 00 00 00 02 30 03    //9			
			29 01 00 00 00 00 02 31 5C    //9			
			29 01 00 00 00 00 02 32 03    //7			
			29 01 00 00 00 00 02 33 70    //7			
			29 01 00 00 00 00 02 34 03    //5			
			29 01 00 00 00 00 02 35 86    //5			
			29 01 00 00 00 00 02 36 03    //3			
			29 01 00 00 00 00 02 37 A7    //3			
			29 01 00 00 00 00 02 38 03    //1			
			29 01 00 00 00 00 02 39 D1    //1			
			29 01 00 00 00 00 02 3A 03    //0			
			29 01 00 00 00 00 02 3B E6    //0			
				  
			29 01 00 00 00 00 02 3C 00    //255			
			29 01 00 00 00 00 02 3D 9B    //255			
			29 01 00 00 00 00 02 3E 00    //254			
			29 01 00 00 00 00 02 3F A7    //254			
			29 01 00 00 00 00 02 40 00    //252			
			29 01 00 00 00 00 02 41 BB    //252			
			29 01 00 00 00 00 02 42 00    //250			
			29 01 00 00 00 00 02 43 CE    //250			
			29 01 00 00 00 00 02 44 00    //248			
			29 01 00 00 00 00 02 45 DE    //248			
			29 01 00 00 00 00 02 46 00    //246			
			29 01 00 00 00 00 02 47 EC    //246			
			29 01 00 00 00 00 02 48 00    //244			
			29 01 00 00 00 00 02 49 F9    //244			
			29 01 00 00 00 00 02 4A 01    //242			
			29 01 00 00 00 00 02 4B 06    //242			
			29 01 00 00 00 00 02 4C 01    //240			
			29 01 00 00 00 00 02 4D 11    //240			
			29 01 00 00 00 00 02 4E 01    //232			
			29 01 00 00 00 00 02 4F 38    //232			
			29 01 00 00 00 00 02 50 01    //224			
			29 01 00 00 00 00 02 51 57    //224			
			29 01 00 00 00 00 02 52 01    //208			
			29 01 00 00 00 00 02 53 8A    //208			
			29 01 00 00 00 00 02 54 01    //192			
			29 01 00 00 00 00 02 55 B4    //192			
			29 01 00 00 00 00 02 56 01    //160			
			29 01 00 00 00 00 02 57 F6    //160			
			29 01 00 00 00 00 02 58 02    //128			
			29 01 00 00 00 00 02 59 2B    //128			
			29 01 00 00 00 00 02 5A 02    //127			
			29 01 00 00 00 00 02 5B 2C    //127			
			29 01 00 00 00 00 02 5C 02    //95			
			29 01 00 00 00 00 02 5D 5C    //95			
			29 01 00 00 00 00 02 5E 02    //63			
			29 01 00 00 00 00 02 5F 90    //63			
			29 01 00 00 00 00 02 60 02    //47			
			29 01 00 00 00 00 02 61 B2    //47			
			29 01 00 00 00 00 02 62 02    //31			
			29 01 00 00 00 00 02 63 E2    //31			
			29 01 00 00 00 00 02 64 03    //23			
			29 01 00 00 00 00 02 65 04    //23			
			29 01 00 00 00 00 02 66 03    //15			
			29 01 00 00 00 00 02 67 31    //15			
			29 01 00 00 00 00 02 68 03    //13			
			29 01 00 00 00 00 02 69 3E    //13			
			29 01 00 00 00 00 02 6A 03    //11			
			29 01 00 00 00 00 02 6B 4D    //11			
			29 01 00 00 00 00 02 6C 03    //9			
			29 01 00 00 00 00 02 6D 5C    //9			
			29 01 00 00 00 00 02 6E 03    //7			
			29 01 00 00 00 00 02 6F 70    //7			
			29 01 00 00 00 00 02 70 03    //5			
			29 01 00 00 00 00 02 71 86    //5			
			29 01 00 00 00 00 02 72 03    //3			
			29 01 00 00 00 00 02 73 A7    //3			
			29 01 00 00 00 00 02 74 03    //1			
			29 01 00 00 00 00 02 75 D1    //1			
			29 01 00 00 00 00 02 76 03    //0			
			29 01 00 00 00 00 02 77 E6    //0			

			29 01 00 00 00 00 02 78 01			
			29 01 00 00 00 00 02 79 01			

			29 01 00 00 00 00 04 FF 78 07 03			

			29 01 00 00 00 00 02 00 00   //255			
			29 01 00 00 00 00 02 01 A8   //255			
			29 01 00 00 00 00 02 02 00   //254			
			29 01 00 00 00 00 02 03 AA   //254			
			29 01 00 00 00 00 02 04 00   //252			
			29 01 00 00 00 00 02 05 BE   //252			
			29 01 00 00 00 00 02 06 00   //250			
			29 01 00 00 00 00 02 07 D0   //250			
			29 01 00 00 00 00 02 08 00   //248			
			29 01 00 00 00 00 02 09 E0   //248			
			29 01 00 00 00 00 02 0A 00   //246			
			29 01 00 00 00 00 02 0B EE   //246			
			29 01 00 00 00 00 02 0C 00   //244			
			29 01 00 00 00 00 02 0D FB   //244			
			29 01 00 00 00 00 02 0E 01   //242			
			29 01 00 00 00 00 02 0F 07   //242			
			29 01 00 00 00 00 02 10 01   //240			
			29 01 00 00 00 00 02 11 12   //240			
			29 01 00 00 00 00 02 12 01   //232			
			29 01 00 00 00 00 02 13 39   //232			
			29 01 00 00 00 00 02 14 01   //224			
			29 01 00 00 00 00 02 15 58   //224			
			29 01 00 00 00 00 02 16 01   //208			
			29 01 00 00 00 00 02 17 8B   //208			
			29 01 00 00 00 00 02 18 01   //192			
			29 01 00 00 00 00 02 19 B5   //192			
			29 01 00 00 00 00 02 1A 01   //160			
			29 01 00 00 00 00 02 1B F6   //160			
			29 01 00 00 00 00 02 1C 02   //128			
			29 01 00 00 00 00 02 1D 2B   //128			
			29 01 00 00 00 00 02 1E 02   //127			
			29 01 00 00 00 00 02 1F 2D   //127			
			29 01 00 00 00 00 02 20 02   //95			
			29 01 00 00 00 00 02 21 5C   //95			
			29 01 00 00 00 00 02 22 02   //63			
			29 01 00 00 00 00 02 23 8F   //63			
			29 01 00 00 00 00 02 24 02   //47			
			29 01 00 00 00 00 02 25 B0   //47			
			29 01 00 00 00 00 02 26 02   //31			
			29 01 00 00 00 00 02 27 DC   //31			
			29 01 00 00 00 00 02 28 02   //23			
			29 01 00 00 00 00 02 29 FA   //23			
			29 01 00 00 00 00 02 2A 03   //15			
			29 01 00 00 00 00 02 2B 22   //15			
			29 01 00 00 00 00 02 2C 03   //13			
			29 01 00 00 00 00 02 2D 2F   //13			
			29 01 00 00 00 00 02 2E 03   //11			
			29 01 00 00 00 00 02 2F 3D   //11			
			29 01 00 00 00 00 02 30 03   //9			
			29 01 00 00 00 00 02 31 4D   //9			
			29 01 00 00 00 00 02 32 03   //7			
			29 01 00 00 00 00 02 33 60   //7			
			29 01 00 00 00 00 02 34 03   //5			
			29 01 00 00 00 00 02 35 75   //5			
			29 01 00 00 00 00 02 36 03   //3			
			29 01 00 00 00 00 02 37 9B   //3			
			29 01 00 00 00 00 02 38 03   //1			
			29 01 00 00 00 00 02 39 CD   //1			
			29 01 00 00 00 00 02 3A 03   //0			
			29 01 00 00 00 00 02 3B E6   //0			

			29 01 00 00 00 00 02 3C 00   //255			
			29 01 00 00 00 00 02 3D A8   //255			
			29 01 00 00 00 00 02 3E 00   //254			
			29 01 00 00 00 00 02 3F AA   //254			
			29 01 00 00 00 00 02 40 00   //252			
			29 01 00 00 00 00 02 41 BE   //252			
			29 01 00 00 00 00 02 42 00   //250			
			29 01 00 00 00 00 02 43 D0   //250			
			29 01 00 00 00 00 02 44 00   //248			
			29 01 00 00 00 00 02 45 E0   //248			
			29 01 00 00 00 00 02 46 00   //246			
			29 01 00 00 00 00 02 47 EE   //246			
			29 01 00 00 00 00 02 48 00   //244			
			29 01 00 00 00 00 02 49 FB   //244			
			29 01 00 00 00 00 02 4A 01   //242			
			29 01 00 00 00 00 02 4B 07   //242			
			29 01 00 00 00 00 02 4C 01   //240			
			29 01 00 00 00 00 02 4D 12   //240			
			29 01 00 00 00 00 02 4E 01   //232			
			29 01 00 00 00 00 02 4F 39   //232			
			29 01 00 00 00 00 02 50 01   //224			
			29 01 00 00 00 00 02 51 58   //224			
			29 01 00 00 00 00 02 52 01   //208			
			29 01 00 00 00 00 02 53 8B   //208			
			29 01 00 00 00 00 02 54 01   //192			
			29 01 00 00 00 00 02 55 B5   //192			
			29 01 00 00 00 00 02 56 01   //160			
			29 01 00 00 00 00 02 57 F6   //160			
			29 01 00 00 00 00 02 58 02   //128			
			29 01 00 00 00 00 02 59 2B   //128			
			29 01 00 00 00 00 02 5A 02   //127			
			29 01 00 00 00 00 02 5B 2D   //127			
			29 01 00 00 00 00 02 5C 02   //95			
			29 01 00 00 00 00 02 5D 5C   //95			
			29 01 00 00 00 00 02 5E 02   //63			
			29 01 00 00 00 00 02 5F 8F   //63			
			29 01 00 00 00 00 02 60 02   //47			
			29 01 00 00 00 00 02 61 B0   //47			
			29 01 00 00 00 00 02 62 02   //31			
			29 01 00 00 00 00 02 63 DC   //31			
			29 01 00 00 00 00 02 64 02   //23			
			29 01 00 00 00 00 02 65 FA   //23			
			29 01 00 00 00 00 02 66 03   //15			
			29 01 00 00 00 00 02 67 22   //15			
			29 01 00 00 00 00 02 68 03   //13			
			29 01 00 00 00 00 02 69 2F   //13			
			29 01 00 00 00 00 02 6A 03   //11			
			29 01 00 00 00 00 02 6B 3D   //11			
			29 01 00 00 00 00 02 6C 03   //9			
			29 01 00 00 00 00 02 6D 4D   //9			
			29 01 00 00 00 00 02 6E 03   //7			
			29 01 00 00 00 00 02 6F 60   //7			
			29 01 00 00 00 00 02 70 03   //5			
			29 01 00 00 00 00 02 71 75   //5			
			29 01 00 00 00 00 02 72 03   //3			
			29 01 00 00 00 00 02 73 9B   //3			
			29 01 00 00 00 00 02 74 03   //1			
			29 01 00 00 00 00 02 75 CD   //1			
			29 01 00 00 00 00 02 76 03   //0			
			29 01 00 00 00 00 02 77 E6   //0			
						
			29 01 00 00 00 00 02 78 01			
			29 01 00 00 00 00 02 79 01			
						
			29 01 00 00 00 00 04 FF 78 07 04			
											 
			29 01 00 00 00 00 02 00 00   //255			
			29 01 00 00 00 00 02 01 83   //255			
			29 01 00 00 00 00 02 02 00   //254			
			29 01 00 00 00 00 02 03 8F   //254			
			29 01 00 00 00 00 02 04 00   //252			
			29 01 00 00 00 00 02 05 A5   //252			
			29 01 00 00 00 00 02 06 00   //250			
			29 01 00 00 00 00 02 07 B7   //250			
			29 01 00 00 00 00 02 08 00   //248			
			29 01 00 00 00 00 02 09 C7   //248			
			29 01 00 00 00 00 02 0A 00   //246			
			29 01 00 00 00 00 02 0B D6   //246			
			29 01 00 00 00 00 02 0C 00   //244			
			29 01 00 00 00 00 02 0D E4   //244			
			29 01 00 00 00 00 02 0E 00   //242			
			29 01 00 00 00 00 02 0F F0   //242			
			29 01 00 00 00 00 02 10 00   //240			
			29 01 00 00 00 00 02 11 FC   //240			
			29 01 00 00 00 00 02 12 01   //232			
			29 01 00 00 00 00 02 13 25   //232			
			29 01 00 00 00 00 02 14 01   //224			
			29 01 00 00 00 00 02 15 46   //224			
			29 01 00 00 00 00 02 16 01   //208			
			29 01 00 00 00 00 02 17 7C   //208			
			29 01 00 00 00 00 02 18 01   //192			
			29 01 00 00 00 00 02 19 A9   //192			
			29 01 00 00 00 00 02 1A 01   //160			
			29 01 00 00 00 00 02 1B EE   //160			
			29 01 00 00 00 00 02 1C 02   //128			
			29 01 00 00 00 00 02 1D 25   //128			
			29 01 00 00 00 00 02 1E 02   //127			
			29 01 00 00 00 00 02 1F 27   //127			
			29 01 00 00 00 00 02 20 02   //95			
			29 01 00 00 00 00 02 21 59   //95			
			29 01 00 00 00 00 02 22 02   //63			
			29 01 00 00 00 00 02 23 8E   //63			
			29 01 00 00 00 00 02 24 02   //47			
			29 01 00 00 00 00 02 25 B0   //47			
			29 01 00 00 00 00 02 26 02   //31			
			29 01 00 00 00 00 02 27 E3   //31			
			29 01 00 00 00 00 02 28 03   //23			
			29 01 00 00 00 00 02 29 0A   //23			
			29 01 00 00 00 00 02 2A 03   //15			
			29 01 00 00 00 00 02 2B 43   //15			
			29 01 00 00 00 00 02 2C 03   //13			
			29 01 00 00 00 00 02 2D 4F   //13			
29 01 00 00 00 00 02 2E 03  //11				
			29 01 00 00 00 00 02 2F 5B   //11			
29 01 00 00 00 00 02 30 03  //9				
			29 01 00 00 00 00 02 31 69   //9			
29 01 00 00 00 00 02 32 03  //7				
29 01 00 00 00 00 02 33 79  //7				
29 01 00 00 00 00 02 34 03  //5				
29 01 00 00 00 00 02 35 8C  //5				
29 01 00 00 00 00 02 36 03  //3				
29 01 00 00 00 00 02 37 AA  //3				
29 01 00 00 00 00 02 38 03  //1				
29 01 00 00 00 00 02 39 D2  //1				
29 01 00 00 00 00 02 3A 03  //0				
29 01 00 00 00 00 02 3B E6  //0				
											 
			29 01 00 00 00 00 02 3C 00   //255			
			29 01 00 00 00 00 02 3D 83   //255			
			29 01 00 00 00 00 02 3E 00   //254			
			29 01 00 00 00 00 02 3F 8F   //254			
			29 01 00 00 00 00 02 40 00   //252			
			29 01 00 00 00 00 02 41 A5   //252			
			29 01 00 00 00 00 02 42 00   //250			
			29 01 00 00 00 00 02 43 B7   //250			
			29 01 00 00 00 00 02 44 00   //248			
			29 01 00 00 00 00 02 45 C7   //248			
			29 01 00 00 00 00 02 46 00   //246			
			29 01 00 00 00 00 02 47 D6   //246			
			29 01 00 00 00 00 02 48 00   //244			
			29 01 00 00 00 00 02 49 E4   //244			
			29 01 00 00 00 00 02 4A 00   //242			
			29 01 00 00 00 00 02 4B F0   //242			
			29 01 00 00 00 00 02 4C 00   //240			
			29 01 00 00 00 00 02 4D FC   //240			
			29 01 00 00 00 00 02 4E 01   //232			
			29 01 00 00 00 00 02 4F 25   //232			
			29 01 00 00 00 00 02 50 01   //224			
			29 01 00 00 00 00 02 51 46   //224			
			29 01 00 00 00 00 02 52 01   //208			
			29 01 00 00 00 00 02 53 7C   //208			
			29 01 00 00 00 00 02 54 01   //192			
			29 01 00 00 00 00 02 55 A9   //192			
			29 01 00 00 00 00 02 56 01   //160			
			29 01 00 00 00 00 02 57 EE   //160			
			29 01 00 00 00 00 02 58 02   //128			
			29 01 00 00 00 00 02 59 25   //128			
			29 01 00 00 00 00 02 5A 02   //127			
			29 01 00 00 00 00 02 5B 27   //127			
			29 01 00 00 00 00 02 5C 02   //95			
			29 01 00 00 00 00 02 5D 59   //95			
			29 01 00 00 00 00 02 5E 02   //63			
			29 01 00 00 00 00 02 5F 8E   //63			
			29 01 00 00 00 00 02 60 02   //47			
			29 01 00 00 00 00 02 61 B0   //47			
			29 01 00 00 00 00 02 62 02   //31			
			29 01 00 00 00 00 02 63 E3   //31			
			29 01 00 00 00 00 02 64 03   //23			
			29 01 00 00 00 00 02 65 0A   //23			
			29 01 00 00 00 00 02 66 03   //15			
			29 01 00 00 00 00 02 67 43   //15			
			29 01 00 00 00 00 02 68 03   //13			
			29 01 00 00 00 00 02 69 4F   //13			
			29 01 00 00 00 00 02 6A 03   //11			
			29 01 00 00 00 00 02 6B 5B   //11			
			29 01 00 00 00 00 02 6C 03   //9			
			29 01 00 00 00 00 02 6D 69   //9			
			29 01 00 00 00 00 02 6E 03   //7			
			29 01 00 00 00 00 02 6F 79   //7			
			29 01 00 00 00 00 02 70 03   //5			
29 01 00 00 00 00 02 71 8C  //5				
29 01 00 00 00 00 02 72 03  //3				
29 01 00 00 00 00 02 73 AA  //3				
29 01 00 00 00 00 02 74 03  //1				
29 01 00 00 00 00 02 75 D2  //1				
29 01 00 00 00 00 02 76 03  //0				
29 01 00 00 00 00 02 77 E6  //0				
				
			29 01 00 00 00 00 02  78 01 			
			29 01 00 00 00 00 02  79 01 
			29 01 00 00 00 00 04  FF 78 07 07    	//Page7	
			29 01 00 00 01 00 02  CE 07 
			29 01 00 00 00 00 02  CE 27 
			29 01 00 00 00 00 04  FF 78 07 05    	//Page5
			29 01 00 00 00 00 02  B0 80
			//29 01 00 00 00 00 04  FF 78 07 08    	//Page8	
			//29 01 00 00 00 00 02  00 02
			//29 01 00 00 00 00 02  27 2f
			29 01 00 00 00 00 04  FF 78 07 07    	//Page7	
			//29 01 00 00 00 00 02  B3 61
			//29 01 00 00 00 00 02  B4 62
			//29 01 00 00 00 00 02  B5 43
			//29 01 00 00 00 00 02  B6 04
			//29 01 00 00 00 00 02  B8 10
			//29 01 00 00 00 00 02  B9 33
			//29 01 00 00 00 00 02  B5 00
			29 01 00 00 00 00 02  C6 DC
			29 01 00 00 00 00 02  CF 57
			//29 01 00 00 00 00 02  CB CF
			//29 01 00 00 00 00 02  CC 80
			
			29 01 00 00 00 00 04  FF 78 07 00    	//Page0
			29 01 00 00 00 00 02  35 00 
			29 01 00 00 00 00 03 51 0F FF
		  	29 01 00 00 00 00 02 53 2c
		 	29 01 00 00 05 00 02 55 01 		
			05 01 00 00 78 00 02  11 00
			05 01 00 00 14 00 02  29 00
			//29 01 00 00 00 00 04  FF 78 07 01
			//29 01 00 00 00 00 02  0a 00
			//29 01 00 00 00 00 02  09 ac  
			//29 01 00 00 00 00 04  FF 78 07 00    	//Page0
			
		];
		qcom,mdss-dsi-off-command = [05 01 00 00 20 00 02 28 00
					                 05 01 00 00 78 00 02 10 00
		];
		
		qcom,mdss-dsi-hfp-power-mode;
				
		qcom,mdss-dsi-on-command-state = "dsi_lp_mode";
		qcom,mdss-dsi-off-command-state = "dsi_lp_mode";

		qcom,mdss-dsi-bl-pmic-control-type = "bl_ctrl_wled";
		qcom,mdss-dsi-reset-sequence = <1 1>, <0 10>, <1 10>;
		qcom,mdss-dsi-tx-eot-append;
		qcom,panel-supply-entries = <&dsi_panel_pwr_supply>;

		qcom,mdss-dsi-panel-status-command = [06 01 00 01 05 00 02 0A 08
											  06 01 00 01 05 00 02 0B 08
											  06 01 00 01 05 00 02 0D 08];
		qcom,mdss-dsi-panel-status-command-state = "dsi_lp_mode";
		qcom,mdss-dsi-panel-status-check-mode = "reg_read";
		qcom,mdss-dsi-panel-status-read-length = <4 4 4>;
		qcom,mdss-dsi-panel-status-valid-params = <1 1 1> ;
		qcom,mdss-dsi-panel-status-value = <0x9c 0x00 0x00>;
		qcom,esd-check-enabled;
		qcom,mdss-dsi-post-init-delay = <1>;
		qcom,mdss-dsi-lp11-init;
	};
};
